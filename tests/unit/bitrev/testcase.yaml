## west.yml
```yaml
# Copyright (c) 2024 Tenstorrent AI ULC
# SPDX-License-Identifier: Apache-2.0

manifest:
  remotes:
    - name: tenstorrent
      url-base: https://github.com/tenstorrent
    - name: tenstorrent-forks
      url-base: https://github.com/tenstorrent-forks
    - name: danieldegrasse
      url-base: https://github.com/danieldegrasse

  # zephyr-keep-sorted-start re(^\s+\- name:)
  projects:
    - name: librpmi
      remote: tenstorrent-forks
      path: modules/lib/librpmi
      revision: 23e94f7007731e91be4de7c1d9c8c48b2173f6a2
    - name: zephyr
      remote: danieldegrasse
      repo-path: zephyr
      revision: 00101fbc013aae67873ad36c539e2e3450b909cb
      import:
        name-allowlist:
          - cmsis_6
          - hal_stm32
          - mbedtls
          - mcuboot
          - nanopb
          - segger
          - tf-psa-crypto
  # zephyr-keep-sorted-stop

  group-filter:
    - +optional
```
