## CMakeLists.txt
```
# Copyright (c) 2026 Tenstorrent AI ULC
# SPDX-License-Identifier: Apache-2.0

cmake_minimum_required(VERSION 3.20.0)
find_package(Zephyr REQUIRED HINTS $ENV{ZEPHYR_BASE})
project(occp)

target_sources(app PRIVATE src/main.c)
```

## prj.conf
```kconfig
CONFIG_LOG=y
CONFIG_OCCP=y
CONFIG_OCCP_BACKEND_I3C=y
CONFIG_OCCP_LOG_LEVEL_DBG=y
CONFIG_TEST=y
CONFIG_ZTEST=y
# VDK simulation does not support programming the PMP with stack protection
CONFIG_TEST_HW_STACK_PROTECTION=n
CONFIG_USERSPACE=n
CONFIG_GPIO=y
```

## boards/tt_mimir_tt_mimir_smc.conf
```kconfig
CONFIG_ZTEST_TC_UTIL_USER_OVERRIDE=y
```

## boards/tt_grendel_smc.overlay
```dts
/*
 * Copyright (c) 2026 Tenstorrent AI ULC
 *
 * SPDX-License-Identifier: Apache-2.0
 */

#include <freq.h>
#include <zephyr/dt-bindings/gpio/gpio.h>

/ {
	zephyr,user {
		/* GPIO61, used by the SMC ROM as a boot signal */
		boot-gpios = <&gpio1 29 GPIO_ACTIVE_HIGH>;
		i3c-pid-high = <0x88fc>;
		i3c-pid-low = <0x1fe8fa15>;
		i3c-dev = <&i3c1>;
	};
};

&uart0 {
	status = "okay";
	current-speed = <115200>;
	/* Set clock frequency so DLAB is programmed to 1 */
	clock-frequency = <2000000>;
};

&i3c1 {
	status = "okay";
	input-clock-frequency = <DT_FREQ_M(150)>;
	i3c-scl-hz = <DT_FREQ_M(12)>; /* 12 MHz I3C SCL frequency */
	i2c-scl-hz = <DT_FREQ_K(300)>; /* 400 kHz I2C SCL frequency */
};
```

## src/main.c
```c
/*
 * Copyright (c) 2026 Tenstorrent AI ULC
 *
 * SPDX-License-Identifier: Apache-2.0
 */

#include <stdio.h>

#include <zephyr/drivers/gpio.h>
#include <zephyr/drivers/i3c.h>
#include <zephyr/ztest.h>
#include <tenstorrent/occp.h>

#include <zephyr/drivers/misc/tt_smc_remoteproc.h>

#define ZEPHYR_USER_NODE DT_PATH(zephyr_user)

const struct device *i3c_dev = DEVICE_DT_GET(DT_PROP(ZEPHYR_USER_NODE, i3c_dev));
const struct gpio_dt_spec boot_gpio = GPIO_DT_SPEC_GET(ZEPHYR_USER_NODE, boot_gpios);
struct i3c_device_desc *remote_smc_dev;
struct occp_backend_i3c occp_backend;

bool occp_before(const void *unused)
{
	int ret;
	struct i3c_device_desc *dev_desc;

	ARG_UNUSED(unused);
	zassert_true(device_is_ready(i3c_dev), "I3C device not ready");
	/* Wait for BOOT GPIO to go high */
	zassert_true(device_is_ready(boot_gpio.port), "BOOT GPIO port not ready");

	gpio_pin_configure_dt(&boot_gpio, GPIO_INPUT);
	while (gpio_pin_get_dt(&boot_gpio) == 0) {
		/* wait */
	}
	ret = i3c_do_daa(i3c_dev);
	zassert_equal(ret, 0, "I3C dynamic address assignment failed: %d", ret);
	/* Find the I3C device */
	I3C_BUS_FOR_EACH_I3CDEV(i3c_dev, dev_desc) {
		if (dev_desc->pid == ((uint64_t)DT_PROP(ZEPHYR_USER_NODE, i3c_pid_high) << 32 |
				      DT_PROP(ZEPHYR_USER_NODE, i3c_pid_low))) {
			TC_PRINT("Found remote_device with PID 0x%012" PRIx64 "\n", dev_desc->pid);
			remote_smc_dev = dev_desc;
			break;
		}
	}
	zassert_not_null(remote_smc_dev, "Failed to get remote SMC device descriptor");
	ret = occp_backend_i3c_init(&occp_backend, remote_smc_dev);
	zassert_equal(ret, 0, "Failed to initialize OCCP I3C backend: %d", ret);

	TC_PRINT("Remote SMC is ready, proceeding with tests\n");
	return true;
}

ZTEST(occp, test_version)
{
	uint8_t major, minor, patch;
	int ret;

	ret = occp_get_version(&occp_backend.base, &major, &minor, &patch);
	zassert_equal(ret, 0, "Failed to get OCCP version: %d", ret);
	zassert_equal(major, 1, "Unexpected OCCP major version: %d", major);
	zassert_equal(minor, 0, "Unexpected OCCP minor version: %d", minor);
	zassert_equal(patch, 0, "Unexpected OCCP patch version: %d", patch);
}

ZTEST(occp, test_read_write)
{
	int ret;
	uint8_t write_data[4] = {0xde, 0xad, 0xbe, 0xef};
	uint8_t read_data[4] = {0};

	/* Write to the start of the SRAM space in SMC we are permitted to use */
	ret = occp_write_data(&occp_backend.base, 0xc0066000, write_data, sizeof(write_data));
	zassert_equal(ret, 0, "Failed to write data via OCCP: %d", ret);

	ret = occp_read_data(&occp_backend.base, 0xc0066000, read_data, sizeof(read_data));
	zassert_equal(ret, 0, "Failed to read data via OCCP: %d", ret);
	zassert_mem_equal(write_data, read_data, sizeof(write_data),
			  "Read data does not match written data");
}

ZTEST_SUITE(occp, occp_before, NULL, NULL, NULL, NULL);
```
