## CMakeLists.txt
```
# Copyright (c) 2025 Tenstorrent AI ULC
# SPDX-License-Identifier: Apache-2.0

cmake_minimum_required(VERSION 3.20.0)
find_package(Zephyr REQUIRED HINTS $ENV{ZEPHYR_BASE})
project(remote_smc_app)

target_sources(app PRIVATE src/main.c)
```

## Kconfig
```
# Copyright (c) 2025 Tenstorrent AI ULC
# Fake out the number of interrupts.
# THIS IS UNSAFE- we are relying on the fact that we
# don't use peripheral interrupts in this BL1 secondary
config NUM_IRQS
	default 12

source "Kconfig.zephyr"
```

## prj.conf
```kconfig
# Make the application as small as possible while still running Zephyr

# No threads
CONFIG_MULTITHREADING=n
CONFIG_KERNEL_MEM_POOL=n
# No timers
CONFIG_SYS_CLOCK_EXISTS=n
# No MPU
CONFIG_MPU=n
CONFIG_RISCV_PMP=n
# Save space by not including the boot banner
CONFIG_TT_BOOT_BANNER=n
```

## boards/tt_grendel_smc.overlay
```dts
#include <freq.h>
#include <zephyr/dt-bindings/gpio/gpio.h>

/*
 * Move RAM to start at 0xc0066000 for secondary SMCs, as this is the first load
 * address the bootrom supports.
 */
&ram0 {
	    reg = <0x0 0xc0066000 0x0 0xfa000>;
};
```

## boards/tt_mimir_tt_mimir_smc.overlay
```dts
#include <freq.h>
#include <zephyr/dt-bindings/gpio/gpio.h>

/*
 * Move RAM to start at 0xc0066400 for secondary SMCs, as this is the first load
 * address the bootrom supports.
 */
&ram0 {
	    reg = <0x0 0xc0066400 0x0 0xf4c00>;
};
```

## src/main.c
```c
/*
 * Copyright (c) 2026 Tenstorrent AI ULC
 *
 * SPDX-License-Identifier: Apache-2.0
 */

#include <stdio.h>
#include <soc.h>

int main(void)
{
	printf("Secondary BL1 is running!\n");

	test_pass();
	return 0;
}
```
