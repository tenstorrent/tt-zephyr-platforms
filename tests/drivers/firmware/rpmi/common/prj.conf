## CMakeLists.txt
```
# SPDX-License-Identifier: Apache-2.0

cmake_minimum_required(VERSION 3.20.0)
find_package(Zephyr REQUIRED HINTS $ENV{ZEPHYR_BASE})
project(rpmi_common)

FILE(GLOB app_sources src/*.c)
target_sources(app PRIVATE ${app_sources})

target_include_directories(app PRIVATE
  ${ZEPHYR_LIBRPMI_MODULE_DIR}/zephyr/include
  ${ZEPHYR_LIBRPMI_MODULE_DIR}/include
)
```

## prj.conf
```kconfig
CONFIG_ZTEST=y

CONFIG_RISCV_RPMI=y
```

## src/main.c
```c
/*
 * Copyright (c) 2024 Tenstorrent AI ULC
 *
 * SPDX-License-Identifier: Apache-2.0
 */

#include <zephyr/ztest.h>

#include <librpmi.h>

ZTEST(rpmi_common, test_nada)
{
	zassert_equal(true, true);
}

ZTEST_SUITE(rpmi_common, NULL, NULL, NULL, NULL, NULL);
```
