## CMakeLists.txt
```
# SPDX-License-Identifier: Apache-2.0

cmake_minimum_required(VERSION 3.20.0)
find_package(Zephyr REQUIRED HINTS $ENV{ZEPHYR_BASE})
project(clock_control_tests)

include_directories(../../../include/)

FILE(GLOB SOURCES src/*.c)
target_sources(app PRIVATE ${SOURCES})
```

## Kconfig
```
# Copyright (c) 2025 Tenstorrent AI ULC
# SPDX-License-Identifier: Apache-2.0

menu "Clock control test options"

config CLOCK_CTRL_TOLERANCE_PERCENT
	int "Tolerance when asserting expected clock frequencies"
	default 1

config CLOCK_CTRL_GDDRCLK_MIN_RATE
	int "Minimum rate to set GDDRCLK to"
	default 750

config CLOCK_CTRL_GDDRCLK_MAX_RATE
	int "Maximum rate to set GDDRCLK to"
	default 1000

config CLOCK_CTRL_GDRRCLK_FREQ_INCR
	int "Increment when changing frequencies for GDDRCLK"
	default 50

config CLOCK_CTRL_AICLK_MIN_RATE
	int "Minimum rate to set AICLK to"
	default 200

config CLOCK_CTRL_AICLK_MAX_RATE
	int "Maximum rate to set AICLK to"
	default 1350

config CLOCK_CTRL_AICLK_FREQ_INCR
	int "Increment when changing frequencies for AICLK"
	default 50

endmenu

source "Kconfig.zephyr"
```

## prj.conf
```kconfig
CONFIG_ZTEST=y

# enable plls
CONFIG_CLOCK_CONTROL=y
```

## src/main.c
```c
/*
 * Copyright (c) 2025 Tenstorrent AI ULC
 *
 * SPDX-License-Identifier: Apache-2.0
 */

#include <zephyr/ztest.h>
#include <zephyr/kernel.h>
#include <zephyr/device.h>
#include <zephyr/drivers/clock_control.h>
#include <zephyr/drivers/clock_control/clock_control_tt_bh.h>
#include <zephyr/sys/printk.h>

ZTEST(clock_control_rate, test_get_rate_aiclk)
{
	const struct device *pll = DEVICE_DT_GET(DT_NODELABEL(pll0));
	uint32_t clock_rate;
	int ret;

	/* Use the actual enum for type safety and clarity */
	clock_control_subsys_t aiclk_subsys =
		(clock_control_subsys_t)CLOCK_CONTROL_TT_BH_CLOCK_AICLK;

	ret = clock_control_get_rate(pll, aiclk_subsys, &clock_rate);
	zassert_ok(ret, "clock_control_get_rate for AICLK failed with %d", ret);
	zassert_equal(clock_rate, 3200, "AICLK rate is %d", clock_rate);
}

ZTEST(clock_control_rate, test_set_rate_gddr)
{
	const struct device *pll = DEVICE_DT_GET(DT_NODELABEL(pll0));
	uint32_t new_rate;
	int ret;

	clock_control_subsys_t gddr_subsys =
		(clock_control_subsys_t)CLOCK_CONTROL_TT_BH_CLOCK_GDDRMEMCLK;

	for (uint32_t target_rate = CONFIG_CLOCK_CTRL_GDDRCLK_MIN_RATE;
	     target_rate <= CONFIG_CLOCK_CTRL_GDDRCLK_MAX_RATE;
	     target_rate += CONFIG_CLOCK_CTRL_GDRRCLK_FREQ_INCR) {
		ret = clock_control_set_rate(pll, gddr_subsys,
					     (clock_control_subsys_rate_t)target_rate);
		zassert_ok(ret, "set_rate for GDDR failed with %d", ret);

		ret = clock_control_get_rate(pll, gddr_subsys, &new_rate);
		zassert_ok(ret, "get_rate for GDDR failed with %d", ret);

		zassert_within(new_rate, target_rate,
			       new_rate / 100.f * CONFIG_CLOCK_CTRL_TOLERANCE_PERCENT,
			       "Expected ~%d Hz but got %d Hz", target_rate, new_rate);
	}
}

ZTEST(clock_control_rate, test_set_rate_aiclk)
{
	const struct device *pll = DEVICE_DT_GET(DT_NODELABEL(pll0));
	uint32_t new_rate;
	int ret;

	clock_control_subsys_t aiclk_subsys =
		(clock_control_subsys_t)CLOCK_CONTROL_TT_BH_CLOCK_AICLK;

	for (uint32_t target_rate = CONFIG_CLOCK_CTRL_AICLK_MIN_RATE;
	     target_rate <= CONFIG_CLOCK_CTRL_AICLK_MAX_RATE;
	     target_rate += CONFIG_CLOCK_CTRL_AICLK_FREQ_INCR) {
		ret = clock_control_set_rate(pll, aiclk_subsys,
					     (clock_control_subsys_rate_t)target_rate);
		zassert_ok(ret, "set_rate for AICLK failed with %d", ret);

		ret = clock_control_get_rate(pll, aiclk_subsys, &new_rate);
		zassert_ok(ret, "get_rate for AICLK failed with %d", ret);

		zassert_within(new_rate, target_rate,
			       new_rate / 100.f * CONFIG_CLOCK_CTRL_TOLERANCE_PERCENT,
			       "Expected ~%d Hz but got %d Hz", target_rate, new_rate);
	}
}

ZTEST(clock_control_rate, test_set_rate_out_of_range_fails)
{
	const struct device *pll = DEVICE_DT_GET(DT_NODELABEL(pll0));
	const uint32_t target_rate = 1000000;
	int ret;

	clock_control_subsys_t gddr_subsys =
		(clock_control_subsys_t)CLOCK_CONTROL_TT_BH_CLOCK_GDDRMEMCLK;

	ret = clock_control_set_rate(pll, gddr_subsys, (clock_control_subsys_rate_t)target_rate);
	zassert_equal(-ERANGE, ret, "Expected -ERANGE but got %d", ret);
}

ZTEST_SUITE(clock_control_rate, NULL, NULL, NULL, NULL, NULL);

ZTEST(clock_control_config, test_configure_unsupported_fails)
{
	const struct device *pll = DEVICE_DT_GET(DT_NODELABEL(pll0));
	void *invalid_option = (void *)99;
	int ret;

	ret = clock_control_configure(pll, NULL, invalid_option);
	zassert_equal(-ENOTSUP, ret, "Expected -ENOTSUP but got %d", ret);
}

ZTEST(clock_control_config, test_configure_bypass_succeeds)
{
	const struct device *pll = DEVICE_DT_GET(DT_NODELABEL(pll0));
	uint32_t initial_rate;
	int ret;

	clock_control_subsys_t aiclk_subsys =
		(clock_control_subsys_t)CLOCK_CONTROL_TT_BH_CLOCK_AICLK;

	ret = clock_control_get_rate(pll, aiclk_subsys, &initial_rate);
	zassert_ok(ret, "Failed to get initial AICLK rate");

	void *bypass_option = (void *)CLOCK_CONTROL_TT_BH_CONFIG_BYPASS;

	ret = clock_control_configure(pll, NULL, bypass_option);
	zassert_ok(ret, "clock_control_configure failed with %d", ret);
}

ZTEST_SUITE(clock_control_config, NULL, NULL, NULL, NULL, NULL);
```
