## CMakeLists.txt
```
#-------------------------------------------------------------------------------
#
# Copyright (c) 2024 Tenstorrent AI ULC
# SPDX-License-Identifier: Apache-2.0
#

cmake_minimum_required(VERSION 3.13.1)
find_package(Zephyr REQUIRED HINTS $ENV{ZEPHYR_BASE})

project(app LANGUAGES C)

# HACK - we shouldn't need to do this.
# We do this to get generated protobuf header files from bh_arc
# Somehow the normal sources and headers are made available but not the build ones
target_link_libraries(app PRIVATE bh_arc)
target_sources(app PRIVATE src/main.c src/init.c)
target_include_directories(app PRIVATE ${CMAKE_CURRENT_SOURCE_DIR}/../../lib/tenstorrent/bh_arc)
```

## prj.conf
```kconfig
# console
CONFIG_CONSOLE=y
CONFIG_RAM_CONSOLE=y

# backlog of library drivers
CONFIG_TT_BH_ARC=y

# logging
CONFIG_LOG=y
CONFIG_TT_APP_LOG_LEVEL_DBG=y

CONFIG_ARC_USE_UNALIGNED_MEM_ACCESS=y
CONFIG_HW_STACK_PROTECTION=n
CONFIG_SYS_CLOCK_TICKS_PER_SEC=1000

# I2C
CONFIG_MULTI_LEVEL_INTERRUPTS=y
CONFIG_I2C_DW=y
CONFIG_I2C=y
CONFIG_SMBUS=y

# protobufs
CONFIG_NANOPB=y

# recovery
CONFIG_TT_SMC_RECOVERY=y
```

## boards/tt_blackhole_tt_blackhole_smc.overlay
```dts
/*
 * Copyright (c) 2024 Tenstorrent AI ULC
 *
 * SPDX-License-Identifier: Apache-2.0
 */

&i2c1 {
	status = "okay";
};

&i2c2 {
	status = "okay";
};
```

## src/main.c
```c
/*
 * Copyright (c) 2024 Tenstorrent AI ULC
 * SPDX-License-Identifier: Apache-2.0
 */

#include <app_version.h>
#include <tenstorrent/msgqueue.h>
#include <tenstorrent/post_code.h>
#include <zephyr/init.h>
#include <zephyr/kernel.h>
#include <zephyr/logging/log.h>

#include "init.h"
#include "init_common.h"
#include "reg.h"
#include "status_reg.h"
#include "smbus_target.h"
#include "fw_table.h"

LOG_MODULE_REGISTER(main, CONFIG_TT_APP_LOG_LEVEL);

int main(void)
{
	SetPostCode(POST_CODE_SRC_CMFW, POST_CODE_ZEPHYR_INIT_DONE);
	printk("Tenstorrent Blackhole CMFW %s\n", APP_VERSION_STRING);

	InitFW();
	InitHW();

	init_msgqueue();

	while (1) {
		PollSmbusTarget();
		k_yield();
	}

	return 0;
}

#define FW_VERSION_SEMANTIC APPVERSION
#define FW_VERSION_DATE     0x00000000
#define FW_VERSION_LOW      0x00000000
#define FW_VERSION_HIGH     0x00000000

uint32_t FW_VERSION[4] __attribute__((section(".fw_version"))) = {
	FW_VERSION_SEMANTIC, FW_VERSION_DATE, FW_VERSION_LOW, FW_VERSION_HIGH};
```

## src/init.c
```c
/*
 * Copyright (c) 2024 Tenstorrent AI ULC
 * SPDX-License-Identifier: Apache-2.0
 */

#include "init.h"

#include <stdint.h>
#include <tenstorrent/post_code.h>

#include "cat.h"
#include "init_common.h"
#include "pll.h"
#include "pcie.h"
#include "read_only_table.h"
#include "reg.h"
#include "smbus_target.h"
#include "status_reg.h"

static uint8_t large_sram_buffer[SCRATCHPAD_SIZE] __aligned(4);

/* Returns 0 on success, non-zero on failure */
uint32_t InitHW(void)
{
	/* Write a status register indicating HW init progress */
	STATUS_BOOT_STATUS0_reg_u boot_status0 = {0};

	boot_status0.val = ReadReg(STATUS_BOOT_STATUS0_REG_ADDR);
	boot_status0.f.hw_init_status = kHwInitStarted;
	WriteReg(STATUS_BOOT_STATUS0_REG_ADDR, boot_status0.val);

	SetPostCode(POST_CODE_SRC_CMFW, POST_CODE_ARC_INIT_STEP1);

	/* Load Read Only table from SPI filesystem */
	/* TODO: Add some kind of error handling if the load fails */
	load_read_only_table(large_sram_buffer, SCRATCHPAD_SIZE);

	SetPostCode(POST_CODE_SRC_CMFW, POST_CODE_ARC_INIT_STEP2);
	/* Enable CATMON for early thermal protection */
	CATInit();

	SetPostCode(POST_CODE_SRC_CMFW, POST_CODE_ARC_INIT_STEP3);
	/* Put all PLLs back into bypass, since tile resets need to be deasserted at low speed */
	PLLAllBypass();
	DeassertTileResets();

	SetPostCode(POST_CODE_SRC_CMFW, POST_CODE_ARC_INIT_STEP4);
	PLLInit();

	SetPostCode(POST_CODE_SRC_CMFW, POST_CODE_ARC_INIT_STEP5);

	SetPostCode(POST_CODE_SRC_CMFW, POST_CODE_ARC_INIT_STEP6);

	SetPostCode(POST_CODE_SRC_CMFW, POST_CODE_ARC_INIT_STEP7);

	/* Initialize pcie0, pcie1 16 lanes as EP */
	SetPostCode(POST_CODE_SRC_CMFW, POST_CODE_ARC_INIT_STEP8);
	FwTable_PciPropertyTable pci_property_table = {
		.pcie_mode = FwTable_PciPropertyTable_PcieMode_EP, .num_serdes = 2};

	if (PCIeInitOk == PCIeInit(0, &pci_property_table)) {
		InitResetInterrupt(0);
	}

	if (PCIeInitOk == PCIeInit(1, &pci_property_table)) {
		InitResetInterrupt(1);
	}

	SetPostCode(POST_CODE_SRC_CMFW, POST_CODE_ARC_INIT_STEP9);

	SetPostCode(POST_CODE_SRC_CMFW, POST_CODE_ARC_INIT_STEPA);

	SetPostCode(POST_CODE_SRC_CMFW, POST_CODE_ARC_INIT_STEPB);
	InitSmbusTarget();

	SetPostCode(POST_CODE_SRC_CMFW, POST_CODE_ARC_INIT_STEPC);

	SetPostCode(POST_CODE_SRC_CMFW, POST_CODE_ARC_INIT_STEPD);

	/* Indicate successful HW Init */
	boot_status0.val = ReadReg(STATUS_BOOT_STATUS0_REG_ADDR);
	boot_status0.f.hw_init_status = kHwInitDone;
	WriteReg(STATUS_BOOT_STATUS0_REG_ADDR, boot_status0.val);

	return 0;
}
```

## src/init.h
```c
/*
 * Copyright (c) 2024 Tenstorrent AI ULC
 * SPDX-License-Identifier: Apache-2.0
 */

#ifndef INIT_H
#define INIT_H

#include <stdint.h>

uint32_t InitHW(void);

#endif
```
