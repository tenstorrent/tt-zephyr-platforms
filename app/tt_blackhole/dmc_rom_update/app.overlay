/*
 * Copyright (c) 2025 Tenstorrent AI ULC
 *
 * SPDX-License-Identifier: Apache-2.0
 */

/* Use slot0 partition definition from legacy bootloader */
&slot0_partition {
	reg = <0x0000c000 (DT_SIZE_K(230) + DT_SIZE_K(2))>;
};
