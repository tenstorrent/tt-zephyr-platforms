/*
 * Copyright (c) 2025 Tenstorrent AI ULC
 *
 * SPDX-License-Identifier: Apache-2.0
 */

#include "tt_blackhole_smc_partitions.dtsi"
#include "tt_blackhole_tt_blackhole_smc.overlay"

/ {
	chosen {
		zephyr,sram = &csm_app;
	};
};
