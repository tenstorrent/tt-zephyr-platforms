/*
 * Copyright (c) 2024 Tenstorrent AI ULC
 *
 * SPDX-License-Identifier: Apache-2.0
 */
&i2c1 {
	status = "disabled";
};

&i2c2 {
	status = "disabled";
};

/*
 * ARC clock will be raised to 800MHz in the application
 */
&sysclk {
	status = "okay";
	clock-frequency = <800000000>;
};

&wdt0 {
	status = "okay";
};
