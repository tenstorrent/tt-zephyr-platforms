## CMakeLists.txt
```
# SPDX-License-Identifier: Apache-2.0

cmake_minimum_required(VERSION 3.20.0)
find_package(Zephyr REQUIRED HINTS $ENV{ZEPHYR_BASE})
project(dmc_rom_update)

FILE(GLOB app_sources src/*.c)
target_sources(app PRIVATE ${app_sources})
```

## sample.yaml
```
sample:
  name: dmc-rom-update
tests:
  dmc-rom-update.app:
    platform_allow:
      - tt_blackhole@p100/tt_blackhole/dmc
      - tt_blackhole@p100a/tt_blackhole/dmc
      - tt_blackhole@p150a/tt_blackhole/dmc
      - tt_blackhole@p300a/tt_blackhole/dmc
    # Runtime tests will be conducted wih the SMC firmware and tt-flash,
    # and this app will be pulled in via sysbuild.
    build_only: true
```

## prj.conf
```kconfig
# For firmware udpates
CONFIG_FLASH=y
CONFIG_FLASH_MAP=y
CONFIG_STREAM_FLASH=y
CONFIG_REBOOT=y

# We always expect MCUBoot to be the primary bootloader
CONFIG_BOOTLOADER_MCUBOOT=y
CONFIG_MCUBOOT_SIGNATURE_KEY_FILE="bootloader/mcuboot/root-rsa-2048.pem"

# Disable printing the default Zephyr boot banner
CONFIG_BOOT_BANNER=n
# Print the Tenstorrent boot banner + git version on startup
CONFIG_TT_BOOT_BANNER=y
CONFIG_TT_BOOT_BANNER_SDK_VERSION=y

CONFIG_FLASH_MAP=y
CONFIG_STREAM_FLASH=y
CONFIG_IMG_MANAGER=y
CONFIG_MCUBOOT_IMG_MANAGER=y
CONFIG_REBOOT=y
```

## app.overlay
```dts
/*
 * Copyright (c) 2025 Tenstorrent AI ULC
 *
 * SPDX-License-Identifier: Apache-2.0
 */

#include "../../boards/tenstorrent/tt_blackhole/tt_blackhole_dmc_bl2.dtsi"

/* Use slot0 partition definition from legacy bootloader */
&slot0_partition {
	reg = <0x0000c000 (DT_SIZE_K(230) + DT_SIZE_K(2))>;
};
```

## src/main.c
```c
/*
 * Copyright (c) 2025 Tenstorrent AI ULC
 *
 * SPDX-License-Identifier: Apache-2.0
 */

#include <zephyr/devicetree.h>
#include <zephyr/drivers/flash.h>
#include <zephyr/dfu/mcuboot.h>
#include <zephyr/kernel.h>
#include <zephyr/storage/flash_map.h>
#include <zephyr/sys/reboot.h>

#define MCUBOOT_PART_NODE  DT_NODE_BY_FIXED_PARTITION_LABEL(mcuboot)
#define BLUPDATE_PART_NODE DT_NODE_BY_FIXED_PARTITION_LABEL(blupdate)

BUILD_ASSERT(DT_FIXED_PARTITION_EXISTS(MCUBOOT_PART_NODE),
	     "No mcuboot partition found in devicetree");
BUILD_ASSERT(DT_FIXED_PARTITION_EXISTS(BLUPDATE_PART_NODE),
	     "No blupdate partition found in devicetree");

uint8_t flash_copy_buf[4 * 1024] __aligned(4);

int main(void)
{
	const struct device *tgt_flash = FIXED_PARTITION_NODE_DEVICE(MCUBOOT_PART_NODE);
	const struct device *src_flash = FIXED_PARTITION_NODE_DEVICE(BLUPDATE_PART_NODE);
	int rc;
	off_t tgt_off, src_off;
	size_t len, erase_len;

	/*
	 * Simply copy the flash data from the bl_update partition to
	 * the MCUBoot partition. There isn't really a recovery path here
	 * if something goes wrong...
	 */
	printk("Starting DMFW rom update...\n");
	tgt_off = DT_REG_ADDR(MCUBOOT_PART_NODE);
	src_off = DT_REG_ADDR(BLUPDATE_PART_NODE);
	len = FIXED_PARTITION_NODE_SIZE(BLUPDATE_PART_NODE);
	/* Erase an additional 0x200 bytes so the new slot0 header will be cleared */
	erase_len = len + 0x200;

	printk("Erasing flash at 0x%lx, size 0x%zx\n", tgt_off, erase_len);
	rc = flash_erase(tgt_flash, tgt_off, erase_len);
	if (rc != 0) {
		printk("Flash erase failed: %d\n", rc);
		return rc;
	}
	printk("Copying 0x%zx bytes from 0x%lx to 0x%lx\n", len, src_off, tgt_off);
	rc = flash_copy(src_flash, src_off, tgt_flash, tgt_off, len, flash_copy_buf,
			sizeof(flash_copy_buf));
	if (rc != 0) {
		printk("Flash copy failed: %d\n", rc);
		return rc;
	}
	printk("DMFW rom update complete\n");
	sys_reboot(SYS_REBOOT_COLD);
	return 0;
}
```
