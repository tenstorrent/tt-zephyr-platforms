## dts/bindings/sensor/ti,ina228.yaml
```yaml
#
# Copyright (c) 2025 Tenstorrent AI ULC
#
# SPDX - License - Identifier : Apache - 2.0
#

description: |
    TI INA228 Ultra-Precise Power/Energy/Charge Monitor With I2C Interface

compatible: "ti,ina228"

include: [sensor-device.yaml, i2c-device.yaml]

properties:
  current-lsb-microamps:
    type: int
    required: true
    description: |
      This value should be selected so that measurement resolution is
      maximized, that is:

        current-lsb(A) = maximum expected current(A) / 2^19

      Rounded values may be used for convenience, e.g. 500uA/LSB or 1mA/LSB
      while keeping a good measurement resolution. The units are in uA/LSB
      so that low maximum currents can be measured with enough resolution.

  rshunt-micro-ohms:
    type: int
    required: true
    description: Shunt resistor value in microOhms

  adc-mode:
    type: string
    description: |
      ADC channel conversion configuration.
      Default is the power-on reset value.
    default: "temp_vbus_vshunt_cont"
    enum:
      - "shutdown_single_shot"
      - "vbus_single_shot"
      - "vshunt_single_shot"
      - "vbus_vshunt_single_shot"
      - "temp_single_shot"
      - "temp_vbus_single_shot"
      - "temp_vshunt_single_shot"
      - "temp_vbus_vshunt_single_shot"
      - "shutdown_cont"
      - "vbus_cont"
      - "vshunt_cont"
      - "vbus_vshunt_cont"
      - "temp_cont"
      - "temp_vbus_cont"
      - "temp_vshunt_cont"
      - "temp_vbus_vshunt_cont"

  vbus-conversion-time-us:
    type: int
    description: |
      Vbus conversion time in microseconds.
      Default is the power-on reset value.
    default: 1052
    enum: [50, 84, 150, 280, 540, 1052, 2074, 4120]

  vshunt-conversion-time-us:
    type: int
    description: |
      Vshunt conversion time in microseconds.
      Default is the power-on reset value.
    default: 1052
    enum: [50, 84, 150, 280, 540, 1052, 2074, 4120]

  temp-conversion-time-us:
    type: int
    description: |
      Temperature conversion time in microseconds.
      Default is the power-on reset value.
    default: 1052
    enum: [50, 84, 150, 280, 540, 1052, 2074, 4120]

  avg-count:
    type: int
    description: |
      Number of samples to average (applies to all inputs).
      Default is the power-on reset value.
    default: 1
    enum: [1, 4, 16, 64, 128, 256, 512, 1024]

  high-precision:
    type: boolean
    description: |
      Enable high precision mode (4x the resolution).

  adc-conversion-delay:
    type: int
    description: |
      Sets the delay for initial ADC conversion in steps of 2 ms.
    default: 0
    enum: [0, 2, 4, 6, 8, 10, 12, 14, 16, 18, 20, 22, 24, 26, 28, 30, 32, 34, 36, 38,
           40, 42, 44, 46, 48, 50, 52, 54, 56, 58, 60, 62, 64, 66, 68, 70, 72, 74, 76, 78,
           80, 82, 84, 86, 88, 90, 92, 94, 96, 98, 100, 102, 104, 106, 108, 110, 112, 114,
           116, 118, 120, 122, 124, 126, 128, 130, 132, 134, 136, 138, 140, 142, 144, 146,
           148, 150, 152, 154, 156, 158, 160, 162, 164, 166, 168, 170, 172, 174, 176, 178,
           180, 182, 184, 186, 188, 190, 192, 194, 196, 198, 200, 202, 204, 206, 208, 210,
           212, 214, 216, 218, 220, 222, 224, 226, 228, 230, 232, 234, 236, 238, 240, 242,
           244, 246, 248, 250, 252, 254, 256, 258, 260, 262, 264, 266, 268, 270, 272, 274,
           276, 278, 280, 282, 284, 286, 288, 290, 292, 294, 296, 298, 300, 302, 304, 306,
           308, 310, 312, 314, 316, 318, 320, 322, 324, 326, 328, 330, 332, 334, 336, 338,
           340, 342, 344, 346, 348, 350, 352, 354, 356, 358, 360, 362, 364, 366, 368, 370,
           372, 374, 376, 378, 380, 382, 384, 386, 388, 390, 392, 394, 396, 398, 400, 402,
           404, 406, 408, 410, 412, 414, 416, 418, 420, 422, 424, 426, 428, 430, 432, 434,
           436, 438, 440, 442, 444, 446, 448, 450, 452, 454, 456, 458, 460, 462, 464, 466,
           468, 470, 472, 474, 476, 478, 480, 482, 484, 486, 488, 490, 492, 494, 496, 498,
           500, 502, 504, 506, 508, 510]

  shunt-temp-comp-en:
    type: boolean
    description: |
      Enables temperature compensation of an external shunt.
```

## dts/bindings/serial/tenstorrent,uart-virt.yml
```yaml
# Copyright (c) 2024 Tenstorrent AI ULC
# SPDX-License-Identifier: Apache-2.0

compatible: "tenstorrent,uart-virt"

description: Tenstorrent Virtual UART

include: uart-controller.yaml

properties:
  tx-buf-size:
    type: int
    default: 256

  rx-buf-size:
    type: int
    default: 256
```

## dts/bindings/watchdog/tenstorrent,bh-watchdog.yaml
```yaml
#
# Copyright (c) 2025 Tenstorrent AI ULC
#
# SPDX-License-Identifier: Apache-2.0
#

description: Tenstorrent BH Watchdog driver

compatible: "tenstorrent,bh-watchdog"

include: base.yaml

properties:
  timeout-ms:
    type: int
    default: 1000
```
