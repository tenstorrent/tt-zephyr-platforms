## dts/bindings/memory-controllers/tenstorrent,bh-memc.yaml
```yaml
# Copyright (c) 2025 Tenstorrent AI ULC
# SPDX-License-Identifier: Apache-2.0

description: |
  Tenstorrent Blackhole DDR memory controller.

compatible: "tenstorrent,bh-memc"

include: base.yaml

properties:
  reg:
    required: true

  clocks:
    required: true

  clock-channels:
    type: array
    required: true
    description: |
      Clock channels w.r.t. phandles contained in 'clocks' used by the memory controller.

  clock-divs:
    type: array
    required: true
    description: |
      Clock dividers for each clock channel.

  flash:
    type: phandle
    required: true
    description: |
      Phandle to the flash device used for firmware loading.

  fwtable:
    type: phandle
    required: true
    description: |
      Phandle to the firmware table device used for reading configuration data.
```

## dts/bindings/mfd/maxim,max6639.yaml
```yaml
# Copyright (c) 2025 Tenstorrent AI ULC
# SPDX-License-Identifier: Apache-2.0

description: |
    Maxim MAX6639 PWM Fan-Speed Controller, MFD device

compatible: "maxim,max6639"

include: [base.yaml, i2c-device.yaml]

bus: max6639
```

## dts/bindings/misc/st,tt-stm32-smbus.yaml
```yaml
# Copyright (c) 2023 SILA Embedded Solutions GmbH
# SPDX-License-Identifier: Apache-2.0

description: TT STM32 SMBus controller

compatible: "st,tt-stm32-smbus"

include: [smbus-controller.yaml, pinctrl-device.yaml]

properties:
  i2c:
    type: phandle
    required: true
    description: I2C device which maps to the same address
```

## dts/bindings/misc/tenstorrent,bh-arc.yaml
```yaml
# Copyright (c) 2024 Tenstorrent AI ULC
# SPDX-License-Identifier: Apache-2.0

compatible: "tenstorrent,bh-arc"

description: |
  Smbus endpoint representing the bh_arc smbus interface.

include: [smbus-device.yaml, base.yaml]

properties:
  gpios:
    type: phandle-array
```

## dts/bindings/misc/tenstorrent,bh-chip.yaml
```yaml
# Copyright (c) 2024 Tenstorrent AI ULC
# SPDX-License-Identifier: Apache-2.0

description: TT Bh Chip reference

compatible: "tenstorrent,bh-chip"

properties:
  flash:
    type: phandle
  bh-smbus:
    type: phandle
  arc:
    type: phandle
  gpio-straps:
    type: phandle-array
```

## dts/bindings/misc/tenstorrent,bh-chips.yaml
```yaml
# Copyright (c) 2024 Tenstorrent AI ULC
# SPDX-License-Identifier: Apache-2.0

description: TT Bh Chip reference

compatible: "tenstorrent,bh-chips"

properties:
  chips:
    type: phandles
    required: true
  primary:
    type: int
    required: true
```

## dts/bindings/misc/tenstorrent,bh-fwtable.yaml
```yaml
# Copyright (c) 2025 Tenstorrent AI ULC
# SPDX-License-Identifier: Apache-2.0

description: Tenstorrent Blackhole Firmware Table

compatible: "tenstorrent,bh-fwtable"

include: base.yaml

properties:

  flash-dev:
    type: phandle
    description: |
      Phandle to the flash device the firmware table resides in. If this property is
      not specified, the firmware table will not be read from SPI flash.
```

## dts/bindings/misc/tenstorrent,bh-pll.yaml
```yaml
# Copyright (c) 2025 Tenstorrent AI ULC
# SPDX-License-Identifier: Apache-2.0

description: Tenstorrent Blackhole PLL

compatible: "tenstorrent,bh-pll"

include: [base.yaml]

properties:
  pll-stride:
    type: int
    required: true

  refdiv:
    type: int
    required: true
  
  fbdiv:
    type: int
    required: true
  
  ctrl-bus1:
    type: int
    required: true
  
  ctrl-bus5:
    type: int
    required: true

  postdiv0:
    type: int
    required: true

  postdiv1:
    type: int
    required: true

  postdiv2:
    type: int
    required: true

  postdiv3:
    type: int
    required: true

  use-postdiv:
    type: int
    required: true
```

## dts/bindings/misc/tenstorrent,noc.yaml
```yaml
# Copyright (c) 2025 Tenstorrent AI ULC
# SPDX-License-Identifier: Apache-2.0

compatible: "tenstorrent,noc"

description: |
  Tenstorrent Network-on-Chip (NOC) Controller

include: base.yaml

properties: {}
```

## dts/bindings/misc/tenstorrent,smc-remoteproc.yaml
```yaml
# Copyright (c) 2025 Tenstorrent AI ULC
# SPDX-License-Identifier: Apache-2.0

description: |
  Tenstorrent SMC remote processor

compatible: "tenstorrent,smc-remoteproc"

include: [i3c-device.yaml]

properties:
  boot-gpios:
    type: phandle-array
    required: true
    description: |
      GPIOs used to boot the remote processor.
```

## dts/bindings/misc/zephyr,jtag-gpio.yaml
```yaml
# Copyright (c) 2024 Tenstorrent AI ULC
# SPDX-License-Identifier: Apache-2.0

compatible: "zephyr,jtag-gpio"

description: |
  This binding is used to describe the JTAG GPIO pins used for JTAG
  communication. The JTAG GPIO pins are used to control the JTAG signals
  (TCK, TDI, TDO, TMS, TRST) for JTAG communication.

include: base.yaml

properties:
  tck-gpios:
    type: phandle-array
    required: true
    description: |
      GPIO pin used for TCK output.

  tdi-gpios:
    type: phandle-array
    required: true
    description: |
      GPIO pin used for TDI output.

  tdo-gpios:
    type: phandle-array
    description: |
      GPIO pin used for TDO input.

  tms-gpios:
    type: phandle-array
    description: |
      GPIO pin used for TMS output.

  trst-gpios:
    type: phandle-array
    description: |
      GPIO pin used for TRST output. Normally, this is active low.

  port-write-cycles:
    type: int
    required: true
    description: |
      Number of processor cycles for I/O Port write operations.For example, the
      GPIO clock may be different from the CPU clock. This can usually be
      found in the SoC documentation.

  tck-delay:
    type: int
    default: 1
    description: |
      Number of microseconds to wait between clock pulses.
```

## dts/bindings/misc/zephyr,smbus-enable.yaml
```yaml
# Copyright (c) 2024 Tenstorrent AI ULC
# SPDX-License-Identifier: Apache-2.0

compatible: "zephyr,smbus-enable"

description: |
  Wraps the smbus in an enable signal.
  Allowing inner devices to automatically and transparently
  enable and disable the bus without needing to explicitly trigger anything.

include: base.yaml

bus: smbus

properties:
  enable:
    type: phandle-array
    required: true
    description: GPIO pin used to enable the endpoint/bus.
```

## dts/bindings/mtd/jedec,mspi-nor.yaml
```yaml
# Copyright (c) 2024 Nordic Semiconductor ASA
# SPDX-License-Identifier: Apache-2.0

description: Generic NOR flash on MSPI bus

compatible: "jedec,mspi-nor"

include: [mspi-device.yaml, "jedec,spi-nor-common.yaml", soc-nv-flash.yaml]

properties:
  reset-gpios:
    type: phandle-array
    description: |
      RESET line. If specified, the flash chip will be reset at initialization.

  t-reset-pulse:
    type: int
    description: |
      Minimum duration, in nanoseconds, of an active pulse on the RESET line.

  t-reset-recovery:
    type: int
    description: |
      Minimum time, in nanoseconds, the flash chip needs to recover after reset.

  mspi-nor-read-frequency:
    type: int
    description: |
      Frequency, in Hz, to use for read operations. If not specified, the same
      frequency as defined by mspi-max-frequency will be used. Only applicable
      when CONFIG_FLASH_MSPI_NOR_RUNTIME_PROBE is enabled.
```

## dts/bindings/mtd/snps,designware-spi-flash.yaml
```yaml
# Copyright (c) 2025 Tenstorrent AI ULC
# SPDX-License-Identifier: Apache-2.0

description: Sysnopsys DesignWare SPI Flash device

include: [spi-device.yaml, "jedec,jesd216.yaml"]

compatible: snps,designware-spi-flash

properties:
  reg:
    required: true
```

## dts/bindings/mtd/tenstorrent,tt-boot-fs.yaml
```yaml
# Copyright (c) 2025 Tenstorrent AI ULC
# SPDX-License-Identifier: Apache-2.0

description: Tenstorrent Flash Partitions

include: ["fixed-partitions.yaml"]

compatible: tenstorrent,tt-boot-fs

properties:
  flash-device-size:
    type: int
    required: true
  flash-block-size:
    type: int
    required: true

child-binding:
  properties:
    binary-path:
      type: string
      description: |
        Path to the binary file to be flashed into this partition. If absent,
        the partition will not be allocated in the final image.
    provisioning-only:
      type: boolean
      description: |
        Set to indicate the partition is only provisioned during manufacturing
    source:
      type: string
      description: |
        Where to place the binary in flash memory. Can be an absolute address,
        or relative to end of flash by referencing $END. If absent, the register
        address is used to determine where the binary is placed in flash.
        If set to $AUTO, the image will be automatically placed as close to
        the start of flash as it will fit.
    padto:
      type: int
      description: |
        Pad the region the binary occupies to support fixed size tt_boot_fs entries.
    executable:
      type: boolean
      description: |
        Set to indicate the partition is executable. This is used to determine
        whether the partition should be loaded into memory and executed by the
        bootloader.
    offset:
      type: int
      description: |
        Address where the bootloader should load an executable binary within memory.
```

## dts/bindings/pll/tenstorrent,bh-pll.yaml
```yaml
# Copyright (c) 2025 Tenstorrent AI ULC
# SPDX-License-Identifier: Apache-2.0

description: Tenstorrent Blackhole PLL

compatible: "tenstorrent,bh-pll"

include: [clock-controller.yaml, base.yaml]

properties:
  reg:
    type: array
    required: true

  "#clock-cells":
    const: 0
```

## dts/bindings/pwm/maxim,max6639-pwm.yaml
```yaml
#
# Copyright (c) 2025 Tenstorrent AI ULC
#
# SPDX - License - Identifier : Apache - 2.0
#

description: |
    Maxim MAX6639 PWM Fan-Speed Controller, PWM device

compatible: "maxim,max6639-pwm"

include: [base.yaml, pwm-controller.yaml, i2c-device.yaml]

properties:
  "#pwm-cells":
    const: 1

pwm-cells:
  - channel
```

## dts/bindings/regulator/maxim,max20730.yaml
```yaml
# Copyright (c) 2025 Tenstorrent AI ULC
# SPDX-License-Identifier: Apache-2.0

description: |
  Analog devices max20730 step-down switching regulator.
  See https://www.analog.com/en/products/max20730.html.

compatible: "maxim,max20730"

include: i2c-device.yaml
```

## dts/bindings/regulator/maxim,max20816.yaml
```yaml
# Copyright (c) 2025 Tenstorrent AI ULC
# SPDX-License-Identifier: Apache-2.0

description: |
  Analog devices max20816 step-down switching regulator.
  See https://www.analog.com/en/products/max20816.html.

compatible: "maxim,max20816"

include: i2c-device.yaml
```

## dts/bindings/reset/tenstorrent,blackhole-reset.yaml
```yaml
# Copyright (c) 2024 Tenstorrent AI ULC
# SPDX-License-Identifier: Apache-2.0

description: Tenstorrrent Blackhole Reset Controller

compatible: "tenstorrent,blackhole-reset"

include: [base.yaml, reset-controller.yaml]

description: |
  The Tenstorrent Blackhole reset controller is used to manage one bank of reset signals occupying
  a 32-bit memory-mapped address.

  There are 3 usage modes.

  1. no mask is specified - 32 reset lines are available to the reset controller instance

    resetX: reset@abcd1234 {
    	compatible = "tenstorrent,blackhole-reset";
     	reg = <0xabcd1234 0x4>;
    	#reset-cells = <1>;
    	status = "okay";
    };

  2. a mask is specified. Only the bits (id values) set high in the mask are valid. In the
    example below, id 1 and id 2 are valid.

    resetX: reset@abcd1234 {
    	compatible = "tenstorrent,blackhole-reset";
     	reg = <0xabcd1234 0x4>;
    	#reset-cells = <1>;
      reset-mask = <0x42>;
    	status = "okay";
    };

  3. a number of resets is specified. In the example below, the least-significant 2 bits are
     available to the reset controller instance. So id 0 and id 1 are valid.

    resetX: reset@abcd1234 {
    	compatible = "tenstorrent,blackhole-reset";
     	reg = <0xabcd1234 0x4>;
    	#reset-cells = <1>;
      nresets = <3>;
    	status = "okay";
    };

  If neither nresets, nor reset-mask is specified, then all 32 reset lines are available.

  Maximally one of nresets or reset-mask may be specified.


properties:
  reg:
    required: true

  nresets:
    type: int
    description: |
      The number of reset lines associated with the reset controller instance.

      This parameter is useful when the lines associated with the reset controller instance are
      contiguous, beginning at bit 0.

      I.e. for nresets = <5>, the value written to the reset register would be equivalent to
      BIT_MASK(5), or 0x1f.

      The valid range for nresets is 0 <= nresets <= 32.

  reset-mask:
    type: int
    description: |
      The bitmask to write to the reset register associated with the reset controller instance.

      This parameter is useful when the lines associated with the reset controller instance are
      non-contiguous.

      I.e. for reset-mask = <0x3fff0000>, only lines 29..16 are affected.

  "#reset-cells":
    const: 1

reset-cells:
- id
```

## dts/bindings/sensor/maxim,max6639-sensor.yaml
```yaml
#
# Copyright (c) 2025 Tenstorrent AI ULC
#
# SPDX - License - Identifier : Apache - 2.0
#

description: |
    Maxim MAX6639 PWM Fan-Speed Controller, RPM sensor

compatible: "maxim,max6639-sensor"

include: [base.yaml, sensor-device.yaml, i2c-device.yaml]
```

## dts/bindings/sensor/tenstorrent,bh-pvt.yaml
```yaml
# Copyright (c) 2025 Tenstorrent AI ULC
# SPDX-License-Identifier: Apache-2.0

description: Tenstorrent Blackhole PVT

compatible: "tenstorrent,bh-pvt"

include: [sensor-device.yaml, base.yaml]

properties:
  reg:
    type: array
    required: true

  num_pd:
    type: int
    required: true
  num_vm:
    type: int
    required: true
  num_ts:
    type: int
    required: true
```
