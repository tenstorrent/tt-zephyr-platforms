## drivers/memc/Kconfig.tt_bh
```kconfig
# Copyright (c) 2024 Tenstorrent AI ULC
# SPDX-License-Identifier: Apache-2.0

config MEMC_TT_BH
	bool "Tenstorrent Blackhole DDR memory controller driver"
	default y
	depends on DT_HAS_TENSTORRENT_BH_MEMC_ENABLED
	help
	  Enable the Tenstorrent Blackhole DDR memory controller driver.


if MEMC_TT_BH

config MEMC_TT_BH_INIT_PRIORITY
	int "Initialization priority for Tenstorrent Blackhole DDR memory controller"
	# this corresponds to POST_KERNEL+18
	default 91
	help
	  Set the initialization priority for the Tenstorrent Blackhole DDR memory controller.

config MEMC_TT_BH_BUF_SIZE
	int "Buffer size for Tenstorrent Blackhole firmware and config data"
	default 512
	help
	  Set the buffer size for Tenstorrent Blackhole firmware and configuration data.

	  Warning: This buffer is stack-allocated!

endif
```

## drivers/mfd/Kconfig
```kconfig
#  Copyright (c) 2025 Tenstorrent AI ULC
#  SPDX-License-Identifier: Apache-2.0

if MFD

menu "MFD Drivers"

# zephyr-keep-sorted-start
rsource "Kconfig.max6639"
# zephyr-keep-sorted-stop

endmenu

endif
```

## drivers/mfd/Kconfig.max6639
```kconfig
# Copyright (c) 2025 Tenstorrent AI ULC
# SPDX-License-Identifier: Apache-2.0

config MFD_MAX6639
	bool "MAX6639 PWM Fan-Speed Controller, MFD device"
	default y
	depends on DT_HAS_MAXIM_MAX6639_ENABLED
	depends on I2C
	help
	  This option enables the Maxim max6639 PWM fan controller.

if MFD_MAX6639

config MFD_MAX6639_INIT_PRIORITY
	int "Priority of max6639 MFD init"
	default 60
	help
	  Priority of max6639 MFD initialization.

endif # MFD_MAX6639
```

## drivers/misc/bh_fwtable/Kconfig
```kconfig
# Copyright (c) 2025 Tenstorrent AI ULC
# SPDX-License-Identifier: Apache-2.0

config BH_FWTABLE
	bool "Tenstorrent Blackhole Firmware Table"
	default y
	depends on DT_HAS_TENSTORRENT_BH_FWTABLE_ENABLED
	depends on TT_BOOT_FS
	help
		Enable the Tenstorrent Blackhole Firmware Table.

if BH_FWTABLE

module = BH_FWTABLE
module-str = bh_fwtable
source "subsys/logging/Kconfig.template.log_config"

endif
```

## drivers/misc/tt_smc_remoteproc/Kconfig
```kconfig
# Copyright (c) 2026 Tenstorrent AI ULC
# SPDX-License-Identifier: Apache-2.0

config TT_SMC_REMOTEPROC
	bool "Tenstorrent SMC Remote Processor Driver"
	default y
	select I3C
	select GPIO
	select OCCP
	depends on DT_HAS_TENSTORRENT_SMC_REMOTEPROC_ENABLED
	help
	  Enable the Remote Processor driver for the Tenstorrent SMC platform.

if TT_SMC_REMOTEPROC

config TT_SMC_REMOTEPROC_INIT_PRIO
	int
	default 75
	help
	  Set the initialization priority of the Tenstorrent SMC Remote Processor driver.

choice OCCP_BACKEND
	default OCCP_BACKEND_I3C
endchoice

endif # TT_SMC_REMOTEPROC
```

## drivers/mspi/Kconfig
```kconfig
#  Copyright (c) 2025 Tenstorrent AI ULC
#  SPDX-License-Identifier: Apache-2.0

if MSPI

menu "MSPI drivers"

# zephyr-keep-sorted-start
rsource "Kconfig.dw"
# zephyr-keep-sorted-stop

endmenu

endif
```

## drivers/mspi/Kconfig.dw
```kconfig
# Copyright (c) 2024 Nordic Semiconductor ASA
# SPDX-License-Identifier: Apache-2.0

config MSPI_DW
	bool "DesignWare SSI controller driver"
	default y
	depends on DT_HAS_SNPS_DESIGNWARE_SSI_ENABLED
	select PINCTRL if $(dt_compat_any_has_prop,$(DT_COMPAT_SNPS_DESIGNWARE_SSI),pinctrl-0)
	imply MSPI_XIP

config MSPI_DW_POLLING
	bool "Use polling mode for DesignWare SSI controller"
	depends on MSPI_DW
	help
	  Use polling mode for transfers instead of interrupts. This
	  will send the entire transfer with interrupts locked, which can
	  be desirable for this controller, as it will deassert CS
	  when the TX FIFO is empty, which can cause issues with
	  systems that have high interrupt latency.
```

## drivers/pinctrl/Kconfig
```kconfig
# Copyright (c) 2024 Tenstorrent AI ULC
# SPDX-License-Identifier: Apache-2.0

if PINCTRL

menu "Pin controller drivers"

# zephyr-keep-sorted-start
rsource "Kconfig.tt_bh"
# zephyr-keep-sorted-stop

endmenu

endif
```

## drivers/pinctrl/Kconfig.tt_bh
```kconfig
# Copyright (c) 2024 Tenstorrent AI ULC
# SPDX-License-Identifier: Apache-2.0

config PINCTRL_TT_BH
	bool "Blackhole pinctrl driver"
	default y
	depends on DT_HAS_TENSTORRENT_BLACKHOLE_PINCTRL_ENABLED
	help
	  Say Y here if you want to enable the Blackhole pinctrl driver.
```

## drivers/pll/Kconfig
```kconfig
#  Copyright (c) 2025 Tenstorrent AI ULC
#  SPDX-License-Identifier: Apache-2.0

menu "PLL drivers"

# zephyr-keep-sorted-start
rsource "Kconfig.tt_bh"
# zephyr-keep-sorted-stop

endmenu
```

## drivers/pll/Kconfig.tt_bh
```kconfig
# Copyright (c) 2025 Tenstorrent AI ULC
# SPDX-License-Identifier: Apache-2.0

config PLL_TT_BH
	bool "Tenstorrent Blackhole PLL"
	default y
	depends on DT_HAS_TENSTORRENT_BH_PLL_ENABLED
	help
		Enable the Tenstorrent Blackhole PLL driver.
```

## drivers/pwm/Kconfig
```kconfig
#  Copyright (c) 2025 Tenstorrent AI ULC
#  SPDX-License-Identifier: Apache-2.0

if PWM

menu "PWM Drivers"

# zephyr-keep-sorted-start
rsource "Kconfig.max6639"
# zephyr-keep-sorted-stop

endmenu

endif
```

## drivers/pwm/Kconfig.max6639
```kconfig
# Copyright (c) 2025 Tenstorrent AI ULC
# SPDX-License-Identifier: Apache-2.0

config PWM_MAX6639
	bool "MAX6639 PWM Fan-Speed Controller, PWM device"
	default y
	depends on DT_HAS_MAXIM_MAX6639_ENABLED
	depends on I2C
	help
	  This option enables the Maxim max6639 PWM fan controller.

if PWM_MAX6639

config PWM_MAX6639_INIT_PRIORITY
	int "Priority of max6639 PWM init"
	default 70
	help
	  Priority of max6639 PWM initialization.

endif # PWM_MAX6639
```

## drivers/reset/Kconfig
```kconfig
# Copyright (c) 2024 Tenstorrent AI ULC
# SPDX-License-Identifier: Apache-2.0

if RESET

menu "Reset Controllers"

# zephyr-keep-sorted-start
rsource "Kconfig.tt_bh"
# zephyr-keep-sorted-stop

endmenu

endif
```

## drivers/reset/Kconfig.tt_bh
```kconfig
# Copyright (c) 2024 Tenstorrent AI ULC
# SPDX-License-Identifier: Apache-2.0

config RESET_TT_BH
	bool "Tenstorrent Blackhole reset controller"
	default y
	depends on DT_HAS_TENSTORRENT_BLACKHOLE_RESET_ENABLED
	help
	  This option enables the Tenstorrent Blackhole reset controller.
```

## drivers/sensor/Kconfig
```kconfig
#  Copyright (c) 2025 Tenstorrent AI ULC
#  SPDX-License-Identifier: Apache-2.0

if SENSOR

menu "Sensor Drivers"

# zephyr-keep-sorted-start
rsource "maxim/Kconfig"
rsource "tenstorrent/Kconfig"
rsource "ti/Kconfig"
# zephyr-keep-sorted-stop

endmenu

endif
```

## drivers/sensor/maxim/Kconfig
```kconfig
#  Copyright (c) 2025 Tenstorrent AI ULC
#  SPDX-License-Identifier: Apache-2.0

rsource "max6639/Kconfig"
```

## drivers/sensor/maxim/max6639/Kconfig
```kconfig
# INA228 Power/Energy/Charge Monitor

# Copyright (c) 2025 Tenstorrent AI ULC
# SPDX-License-Identifier: Apache-2.0


config MAX6639_SENSOR
	bool "MAX6639 PWM Fan-Speed Controller, Sensor device"
	default y
	depends on DT_HAS_MAXIM_MAX6639_ENABLED
	depends on I2C
	help
	  This option enables the Maxim max6639 PWM fan controller.

if MAX6639_SENSOR

config MAX6639_SENSOR_INIT_PRIORITY
	int "Priority of max6639 sensor init"
	default 80
	help
	  Priority of max6639 sensor initialization.

endif # MAX6639_SENSOR
```

## drivers/sensor/tenstorrent/Kconfig
```kconfig
#  Copyright (c) 2025 Tenstorrent AI ULC
#  SPDX-License-Identifier: Apache-2.0

# zephyr-keep-sorted-start
rsource "pvt/Kconfig"
# zephyr-keep-sorted-stop
```

## drivers/sensor/tenstorrent/pvt/Kconfig
```kconfig
# Copyright (c) 2025 Tenstorrent AI ULC
# SPDX-License-Identifier: Apache-2.0

config PVT_TT_BH
	bool "Tenstorrent Blackhole PVT driver"
	default y
	depends on DT_HAS_TENSTORRENT_BH_PVT_ENABLED
	help
		Enable the Tenstorrent Blackhole process, voltage and temperature driver.
```

## drivers/sensor/ti/ina228/Kconfig
```kconfig
# INA228 Power/Energy/Charge Monitor

# Copyright (c) 2025 Tenstorrent AI ULC
# SPDX-License-Identifier: Apache-2.0


config INA228
	bool "INA228 Power/Energy/Charge Monitor"
	default y
	depends on DT_HAS_TI_INA228_ENABLED
	depends on I2C
	help
	  Enable driver for INA228 Power/Energy/Charge Monitor

config INA228_VSHUNT
	bool "INA228 VShunt Measurement Enable"
	depends on INA228
	help
	  Enable shunt voltage measurement for INA228.

	  This is the actual shunt voltage measured which is scaled within the
	  INA228 based upon the SHUNT_CAL register. This value is useful for
	  determining the measurement noise or debugging the SHUNT_CAL value.

	  Note that enabling this option requires an extra I2C read when the
	  SENSOR_CHAN_ALL is selected. Hence, only enable this option if the
	  shunt voltage measurement is required.
```

## drivers/sensors/ti/Kconfig
```kconfig
#  Copyright (c) 2025 Tenstorrent AI ULC
#  SPDX-License-Identifier: Apache-2.0

rsource "ina228/Kconfig"
```

## drivers/serial/Kconfig
```kconfig
# Copyright (c) 2024 Tenstorrent AI ULC
# SPDX-License-Identifier: Apache-2.0

if SERIAL

menu "Serial drivers"

# zephyr-keep-sorted-start
rsource "Kconfig.tt_virt"
# zephyr-keep-sorted-stop

endmenu

endif
```

## drivers/serial/Kconfig.tt_virt
```kconfig
# Copyright (c) 2024 Tenstorrent AI ULC
# SPDX-License-Identifier: Apache-2.0

config UART_TT_VIRT
	bool "Tenstorrent virtual UART driver"
	default y
	depends on DT_HAS_TENSTORRENT_VUART_ENABLED
	select SERIAL_HAS_DRIVER
	select SERIAL_SUPPORT_INTERRUPT
	help
	  Enable the Tenstorrent virtual UART driver.

config UART_TT_VIRT_INTERRUPT_INTERVAL
	int "Interval (in ms) to check UART state for fake interrupt support"
	default 100
	depends on (UART_TT_VIRT && UART_INTERRUPT_DRIVEN)
	help
	  The virtual UART driver is memory based, and lacks support for
	  hardware interrupts. Therefore we use a software timer on a set
	  interval to fake this support where required. This setting
	  allows adjusting the interval of the software timer.
```

## drivers/smbus/Kconfig
```kconfig
# Copyright (c) 2025 Tenstorrent AI ULC
#
# SPDX-License-Identifier: Apache-2.0

if SMBUS

menu "SMBUS"

# zephyr-keep-sorted-start
rsource "Kconfig.tt"
# zephyr-keep-sorted-stop

endmenu

endif
```
