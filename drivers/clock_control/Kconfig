## drivers/clock_control/Kconfig
```kconfig
#  Copyright (c) 2025 Tenstorrent AI ULC
#  SPDX-License-Identifier: Apache-2.0

if CLOCK_CONTROL

menu "Clock control drivers"

# zephyr-keep-sorted-start
rsource "Kconfig.emul"
rsource "Kconfig.tt_bh"
rsource "Kconfig.tt_gr"
# zephyr-keep-sorted-stop

endmenu

endif
```

## drivers/clock_control/Kconfig.emul
```kconfig
# Copyright (c) 2025 Tenstorrent AI ULC
# SPDX-License-Identifier: Apache-2.0

config CLOCK_CONTROL_EMUL
	bool "Enabled Clock Control Emulation"
	depends on EMUL
	help
		Enable the Clock Control Emulation driver
```

## drivers/clock_control/Kconfig.tt_bh
```kconfig
# Copyright (c) 2025 Tenstorrent AI ULC
# SPDX-License-Identifier: Apache-2.0

config CLOCK_CONTROL_TT_BH
	bool "Tenstorrent Blackhole Clock Control"
	default y
	depends on DT_HAS_TENSTORRENT_BH_CLOCK_CONTROL_ENABLED
	help
	  Enable the Tenstorrent Blackhole Clock Control driver.

if CLOCK_CONTROL_TT_BH

config CLOCK_CONTROL_TT_BH_PLL_COMMON_INIT
	bool "Initialize Blackhole PLLs all at once"
	help
	  Rather than initializing each PLL individually, this option allows
	  the driver to initialize all PLLs at once, which can be more efficient.

config CLOCK_CONTROL_TT_BH_LOCK_TIMEOUT_MS
	int "Timeout for PLL lock in milliseconds"
	range 1 10000
	default 400
	help
	  Specify the timeout for PLL lock in milliseconds. This is the maximum
	  time the driver will wait for a PLL to lock before giving up.

endif
```

## drivers/clock_control/Kconfig.tt_gr
```kconfig
# Copyright (c) 2026 Tenstorrent AI ULC
# SPDX-License-Identifier: Apache-2.0

config CLOCK_CONTROL_TT_GRENDEL
	bool "Tenstorrent Grendel Clock Control"
	default y
	depends on DT_HAS_TENSTORRENT_GRENDEL_CLOCK_CONTROL_ENABLED
	help
	  Enable the Tenstorrent Grendel Clock Control driver for
	  the Movellus Aeonic Generate CGM.

config CLOCK_CONTROL_TT_GRENDEL_LOCK_TIMEOUT
	int "CGM lock timeout in milliseconds"
	default 400
	depends on CLOCK_CONTROL_TT_GRENDEL
	help
	  Maximum time to wait for the CGM to achieve frequency lock
	  after programming via the APB interface.
```

## drivers/clock_control/Kconfig.tt_grendel
```kconfig
# Copyright (c) 2026 Tenstorrent AI ULC
# SPDX-License-Identifier: Apache-2.0

config CLOCK_CONTROL_TT_GRENDEL
	bool "Tenstorrent Grendel Clock Control"
	default y
	depends on DT_HAS_TENSTORRENT_GRENDEL_CLOCK_CONTROL_ENABLED
	help
		Enable the Tenstorrent Grendel Clock Control driver.
```

## drivers/console/Kconfig
```kconfig
# Copyright (c) 2025 Tenstorrent AI ULC
# SPDX-License-Identifier: Apache-2.0

config TENSTORRENT_VIRT_CONSOLE
	bool "Tenstorrent Virtual Console"
	help
	  Enable the Tenstorrent Virtual Console driver. This driver
	  writes console output to scratch register 2, which is used
	  by simulation hosts to display console output.
```

## drivers/dma/Kconfig
```kconfig
#  Copyright (c) 2025 Tenstorrent AI ULC
#  SPDX-License-Identifier: Apache-2.0

if DMA

menu "DMA drivers"

# zephyr-keep-sorted-start
rsource "Kconfig.arc_hs"
rsource "Kconfig.tt_bh"
rsource "Kconfig.tt_grendel"
# zephyr-keep-sorted-stop

endmenu

endif
```

## drivers/dma/Kconfig.arc_hs
```kconfig
# Copyright (c) 2025 Tenstorrent AI ULC
# SPDX-License-Identifier: Apache-2.0

config DMA_ARC_HS
	bool "ARC DMA driver"
	default y
	depends on DT_HAS_SNPS_DESIGNWARE_DMA_ARC_HS_ENABLED
	help
	  DMA driver for ARC MCUs.
```

## drivers/dma/Kconfig.tt_bh
```kconfig
# Copyright (c) 2025 Tenstorrent AI ULC
# SPDX-License-Identifier: Apache-2.0

config DMA_TT_BH_NOC
	bool "Tenstorrent Blackhole NOC DMA"
	default y
	depends on DT_HAS_TENSTORRENT_NOC_DMA_ENABLED
	help
		Enable the Tenstorrent Blackhole NOC DMA driver.
```

## drivers/dma/Kconfig.tt_grendel
```kconfig
# Copyright (c) 2025 Tenstorrent AI ULC
# SPDX-License-Identifier: Apache-2.0

config DMA_TT_GRENDEL_SMC
	bool "Tenstorrent Grendel SMC AXI DMA driver"
	default y
	depends on DT_HAS_TENSTORRENT_GRENDEL_SMC_DMA_ENABLED
	help
	  Enable the Tenstorrent Grendel SMC AXI DMA controller driver.
	  This driver supports memory-to-memory DMA transfers using the
	  hardware AXI DMA engine on the Grendel SMC.

config DMA_TT_GRENDEL_SMC_TIMEOUT_MS
	int "DMA transfer timeout in milliseconds"
	default 1000
	depends on DMA_TT_GRENDEL_SMC
	help
	  Maximum time to wait for a single DMA block transfer to complete.
	  The hardware lacks a completion interrupt, so the driver polls
	  the DONE register until this timeout expires.

config DMA_TT_GRENDEL_SMC_MAX_BLOCKS
	int "Maximum number of blocks per transfer"
	default 4
	depends on DMA_TT_GRENDEL_SMC
	help
	  Maximum number of DMA blocks that can be chained in a single
	  transfer.
```

## drivers/flash/Kconfig
```kconfig
#  Copyright (c) 2025 Tenstorrent AI ULC
#  SPDX-License-Identifier: Apache-2.0

if FLASH

menu "Flash drivers"

config FLASH_TT_STM32_WRAPPER
	bool "Tenstorrent STM32 Flash Wrapper"
	default y
	select SOC_FLASH_STM32
	depends on DT_HAS_TENSTORRENT_STM32_FLASH_WRAPPER_ENABLED
	help
	  Support for Tenstorrent STM32 Flash Wrapper driver.
	  This is a wrapper around the standard STM32 flash driver
	  that fakes the flash page size to 4KB for MCUs with 2K pages.

endmenu

endif
```

## drivers/flash/Kconfig.mspi
```kconfig
# Copyright (c) 2024 Ambiq Micro Inc. <www.ambiq.com>
# SPDX-License-Identifier: Apache-2.0

menu "MSPI flash device driver"

menuconfig FLASH_MSPI_NOR
	bool "Generic MSPI NOR Flash"
	default y
	depends on DT_HAS_JEDEC_MSPI_NOR_ENABLED
	select FLASH_MSPI
	select FLASH_HAS_EXPLICIT_ERASE
	select FLASH_HAS_PAGE_LAYOUT
	select FLASH_JESD216
	select GPIO if $(dt_compat_any_has_prop,$(DT_COMPAT_JEDEC_MSPI_NOR),reset-gpios)

if FLASH_MSPI_NOR

config FLASH_MSPI_NOR_LAYOUT_PAGE_SIZE
	int "Page size to use for FLASH_LAYOUT feature"
	depends on FLASH_PAGE_LAYOUT
	default 65536
	help
	  When CONFIG_FLASH_PAGE_LAYOUT is used, this driver will support that
	  API. By default the page size corresponds to the block size (65536).
	  Other options include the 32K-byte erase size (32768), the sector
	  size (4096), or any non-zero multiple of the sector size.

config FLASH_MSPI_NOR_RUNTIME_PROBE
	bool "Probe flash details at runtime"
	help
	  If enabled, the driver will probe the flash device's JEDEC ID at
	  runtime, and used that to determine the command set and flash size.

config FLASH_MSPI_NOR_WRITE_MAX
	int "Maximum write size"
	default 65536
	help
	  Maximum number of bytes that can be written in a single write operation.
	  Can be used to limit max write size for flash devices that require it,
	  or bugging mspi controllers that cannot handle large transfers.

config FLASH_MSPI_NOR_READ_MAX
	int "Maximum read size"
	default 65536
	help
	  Maximum number of bytes that can be read in a single read operation.
	  Can be used to limit max read size for flash devices that require it,
	  or bugging mspi controllers that cannot handle large transfers.

config FLASH_MSPI_NOR_LIMIT_POLLING
	bool "Limit status polling speed"
	default y
	help
	  If enabled, the driver will add a small delay between each poll of the
	  flash device's status register when waiting for operations to complete.

endif # FLASH_MSPI_NOR

endmenu
```

## drivers/flash/Kconfig.spi_dw
```kconfig
#  Copyright (c) 2025 Tenstorrent AI ULC
#  SPDX-License-Identifier: Apache-2.0

config FLASH_SPI_DW
	bool "SPI DW flash driver"
	default y
	select FLASH_HAS_DRIVER_ENABLED
	select FLASH_HAS_EXPLICIT_ERASE
	select FLASH_JESD216
	select FLASH_HAS_PAGE_LAYOUT
	select FLASH_HAS_EX_OP
	depends on DT_HAS_SNPS_DESIGNWARE_SPI_ENABLED && !SPI_DW

if FLASH_SPI_DW

config FLASH_SPI_DW_TIMEOUT
	int "SPI DW flash transfer timeout (ms)"
	default 1000
	help
	  Timeout in milliseconds for SPI DW flash transfers.

config FLASH_SPI_DW_PROG_TIMEOUT
	int "SPI DW flash program timeout (ms)"
	default 10000
	help
	  Timeout in milliseconds for SPI DW flash program and erase operations

config FLASH_SPI_DW_DEV_INIT_PRIO
	int "SPI DW flash device initialization priority"
	default 60
	help
	  Priority for SPI DW flash device initialization. Must be greater than
	  the flash initialization priority

endif # FLASH_SPI_DW
```

## drivers/gpio/Kconfig
```kconfig
#  Copyright (c) 2025 Tenstorrent AI ULC
#  SPDX-License-Identifier: Apache-2.0

if GPIO

menu "GPIO drivers"

# zephyr-keep-sorted-start
rsource "Kconfig.tt_bh"
rsource "Kconfig.tt_gr"
# zephyr-keep-sorted-stop

endmenu

endif
```

## drivers/gpio/Kconfig.tt_bh
```kconfig
# Copyright (c) 2025 Tenstorrent AI ULC
# SPDX-License-Identifier: Apache-2.0

config GPIO_TT_BH
	bool "Tenstorrent Blackhole GPIO"
	depends on GPIO
	help
		Enable the Tenstorrent Blackhole GPIO driver.
```

## drivers/gpio/Kconfig.tt_gr
```kconfig
# Copyright (c) 2025 Tenstorrent AI ULC
# SPDX-License-Identifier: Apache-2.0

config GPIO_TT_GRENDEL
	bool "Tenstorrent Grendel GPIO Driver"
	default y
	depends on DT_HAS_TENSTORRENT_GRENDEL_GPIO_ENABLED
	help
	  Enable the GPIO driver for the Tenstorrent Grendel platform.
```

## drivers/i2c/Kconfig
```kconfig
# Copyright (c) 2025 Tenstorrent AI ULC
# SPDX-License-Identifier: Apache-2.0

if I2C

menu "I2C Drivers"

# zephyr-keep-sorted-start
rsource "Kconfig.tt_stm32"
# zephyr-keep-sorted-stop

endmenu

endif
```

## drivers/i2c/Kconfig.tt_bh
```kconfig
# Copyright (c) 2025 Tenstorrent AI ULC
# SPDX-License-Identifier: Apache-2.0

config I2C_TT_BH
	bool "Tenstorrent Blackhole I2C driver"
	default y
	depends on DT_HAS_TENSTORRENT_BH_I2C_ENABLED
	help
	  Enable the Tenstorrent Blackhole I2C driver.

if I2C_TT_BH

config I2C_TT_BH_INIT_PRIORITY
	int "Tenstorrent Blackhole I2C init priority"
	default 51
	help
	  Initialization priority for the Tenstorrent Blackhole I2C driver.

endif
```

## drivers/i2c/Kconfig.tt_stm32
```kconfig
# Copyright (c) 2019 Phytec Messtechnik GmbH
#
# SPDX-License-Identifier: Apache-2.0

config TT_I2C_DRIVER
	bool "stm32 i2c driver with some customizations [EXPERIMENTAL]"
	select EXPERIMENTAL

if TT_I2C_DRIVER

module = TT_I2C_DRIVER
module-str = tt i2c drv
source "subsys/logging/Kconfig.template.log_config"

config TT_I2C_STM32_INTERRUPT
	bool "STM32 MCU I2C Interrupt Support"
	default y
	help
	  Enable Interrupt support for the I2C Driver

config TT_I2C_STM32_POLL
	bool "Use simple byte polling instead of the NBYTES counter"
	default n
	help
	  Enable Use single byte polling instead of multibyte

config TT_I2C_STM32_BYTE_POLL
	bool "Use simple byte polling instead of the NBYTES counter"
	default n
	help
	  Enable Use single byte polling instead of multibyte

config TT_I2C_STM32_COMBINED_INTERRUPT
	bool
	depends on TT_I2C_STM32_INTERRUPT
	default y if SOC_SERIES_STM32C0X || SOC_SERIES_STM32F0X || \
		     SOC_SERIES_STM32G0X || SOC_SERIES_STM32L0X

config TT_I2C_STM32_BUS_RECOVERY
	bool "Bus recovery support"
	select I2C_BITBANG
	help
	  Enable STM32 driver bus recovery support via GPIO bitbanging.

config TT_I2C_STM32_TIMEOUT
	int "The bus timeout in ms (how long we will wait for target before aborting)"
	default 500
	depends on !TT_I2C_STM32_INTERRUPT
	help
	  The length of time (in ms) driver will wait for target to show activity before aborting

config TT_I2C_STM32_SELECT_GPIOS
	bool
	default y if TT_I2C_STM32_BUS_RECOVERY || TT_I2C_STM32_BYTE_POLL


endif # JTAG_DRIVER
```

## drivers/jtag/Kconfig
```kconfig
# Copyright (c) 2024 Tenstorrent AI ULC
#
# SPDX-License-Identifier: Apache-2.0

menuconfig JTAG
	bool "JTAG Drivers"

if JTAG

module = JTAG
module-str = jtag drv
source "subsys/logging/Kconfig.template.log_config"

config JTAG_INIT_PRIO
	int "JTAG driver initialization priority"
	default 80
	help
	  Set the initialization priority number.

config JTAG_SHELL
	bool "JTAG shell"
	default y
	depends on SHELL
	help
	  Enable JTAG shell commands.

config JTAG_USE_MMAPPED_IO
	bool "Use memory-mapped I/O for JTAG"
	help
	  If this option is enabled, the JTAG driver will use memory-mapped I/O
	  to access the JTAG hardware. This is the preferred method for most
	  systems, but may not be supported on all platforms.

# zephyr-keep-sorted-start
rsource "Kconfig.bitbang"
rsource "Kconfig.emul"
# zephyr-keep-sorted-stop

endif # JTAG
```

## drivers/jtag/Kconfig.bitbang
```kconfig
# Copyright (c) 2024 Tenstorrent AI ULC
#
# SPDX-License-Identifier: Apache-2.0

config JTAG_BITBANG
	bool "JTAG Port bit-bang driver"
	default y
	depends on DT_HAS_ZEPHYR_JTAG_GPIO_ENABLED
	depends on GPIO
```

## drivers/jtag/Kconfig.emul
```kconfig
# Copyright (c) 2024 Tenstorrent AI ULC
#
# SPDX-License-Identifier: Apache-2.0

config JTAG_EMUL
	bool "JTAG Port emul driver"
	depends on JTAG_BITBANG
	help
	  Enable the callback to track axi reads and writes using the gpio
	  emul infra.
```

## drivers/mbox/Kconfig
```kconfig
# Copyright (c) 2026 Tenstorrent AI ULC
# SPDX-License-Identifier: Apache-2.0

if MBOX

menu "MBOX drivers"

# zephyr-keep-sorted-start
rsource "Kconfig.tt_gr"
# zephyr-keep-sorted-stop

endmenu

endif
```

## drivers/mbox/Kconfig.tt_gr
```kconfig
# Copyright (c) 2026 Tenstorrent AI ULC
# SPDX-License-Identifier: Apache-2.0

config MBOX_TT_GRENDEL
	bool "Grendel Mailbox Driver"
	default y
	depends on DT_HAS_TENSTORRENT_GRENDEL_MBOX_ENABLED
	help
	  Enable support for the Grendel mailbox driver.
```

## drivers/memc/Kconfig
```kconfig
# Copyright (c) 2024 Tenstorrent AI ULC
# SPDX-License-Identifier: Apache-2.0

if MEMC

menu "Memory controller drivers [EXPERIMENTAL]"

# zephyr-keep-sorted-start
rsource "Kconfig.tt_bh_ddr"
# zephyr-keep-sorted-stop

endmenu

endif
```
