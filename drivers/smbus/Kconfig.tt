## drivers/smbus/Kconfig.tt
```kconfig
# Copyright (c) 2019 Phytec Messtechnik GmbH
#
# SPDX-License-Identifier: Apache-2.0

config TT_SMBUS_DRIVER
	bool "stm32 smbus driver with some customizations [EXPERIMENTAL]"
	select EXPERIMENTAL
	select CRC

if TT_SMBUS_DRIVER

module = TT_SMBUS_DRIVER
module-str = tt smbus drv
source "subsys/logging/Kconfig.template.log_config"

config SMBUS_TT_STM32_SMBALERT
	bool "SMBus STM32 SMBALERT signal support"
	default y
	help
	  Support SMBALERT signal from peripheral devices.

endif # JTAG_DRIVER
```

## drivers/smbus_target/Kconfig
```kconfig
#  Copyright (c) 2025 Tenstorrent AI ULC
#  SPDX-License-Identifier: Apache-2.0

if I2C_TARGET

menu "SMBUS target driver"

# zephyr-keep-sorted-start
rsource "Kconfig.smbus_target"
# zephyr-keep-sorted-stop

endmenu

endif #I2C_TARGET
```

## drivers/smbus_target/Kconfig.smbus_target
```kconfig
# Copyright (c) 2025 Tenstorrent AI ULC
# SPDX-License-Identifier: Apache-2.0

config SMBUS_TARGET
	bool "SMBUS target driver"
	depends on CRC
	help
	  Enable the SMBUS target driver

if SMBUS_TARGET

config SMBUS_MAX_MSG_SIZE
	int "SMBUS maximum message size"
	default 64
	help
	  The maximum SMBUS transaction size. This is used
	  to size internal buffers storing the transaction input/output.
endif #SMBUS_TARGET
```

## drivers/tenstorrent/Kconfig
```kconfig
#  Copyright (c) 2025 Tenstorrent AI ULC
#  SPDX-License-Identifier: Apache-2.0

menu "Tenstorrent Device Drivers"

# zephyr-keep-sorted-start
rsource "fuse/Kconfig"
rsource "timer/Kconfig"
# zephyr-keep-sorted-stop

endmenu
```

## drivers/tenstorrent/fuse/Kconfig
```kconfig
# Copyright (c) 2025 Tenstorrent AI ULC
# SPDX-License-Identifier: Apache-2.0

config TT_FUSE
	bool "Enable Tenstorrent Fuse drivers"
	help
	  Enable Tenstorrent Fuse drivers.

if TT_FUSE

config TT_BH_ARC_EFUSE
	bool "Enable ARC EFUSE driver for Tenstorrent Blackhole"
	help
	  Enable the ARC EFUSE driver for Tenstorrent Blackhole SOC.

endif # TT_FUSE
```

## drivers/tenstorrent/timer/Kconfig
```kconfig
# Copyright (c) 2025 Tenstorrent AI ULC
# SPDX-License-Identifier: Apache-2.0

config TT_TIMER
	bool "Enable Tenstorrent Timer driver"
	help
	  Enable Tenstorrent Timer drivers.

if TT_TIMER

config TT_BH_ARC_TIMER
	bool "Enable ARC RefClk Timer driver for Tenstorrent Blackhole"
	help
	  Enable the ARC RefClk Timer driver for Tenstorrent Blackhole SOC.

endif # TT_TIMER
```

## drivers/watchdog/Kconfig
```kconfig
# Copyright (c) 2025 Tenstorrent AI ULC
# SPDX-License-Identifier: Apache-2.0

if WATCHDOG

menu "Watchdog drivers"

# zephyr-keep-sorted-start
rsource "Kconfig.tt_bh"
# zephyr-keep-sorted-stop

endmenu

endif
```

## drivers/watchdog/Kconfig.tt_bh
```kconfig
# Copyright (c) 2025 Tenstorrent AI ULC
# SPDX-License-Identifier: Apache-2.0

config WDT_TT_BH
	bool "Tenstorrent Blackhole watchdog driver"
	default y
	depends on DT_HAS_TENSTORRENT_BH_WATCHDOG_ENABLED
	help
	  Enable the Tenstorrent Blackhole watchdog driver.
```

## dts/bindings/avs/tenstorrent,avs.yaml
```yaml
# Copyright (c) 2025 Tenstorrent AI ULC
# SPDX-License-Identifier: Apache-2.0

compatible: "tenstorrent,avs"

description: |
  Tenstorrent AVS driver

  The AVS (Adaptive Voltage Scaling) driver is used for dynamically scaling supply voltage.

include: base.yaml

properties:
  reg:
    required: true
```

## dts/bindings/clock-control/tenstorrent,bh-clock-control.yaml
```yaml
# Copyright (c) 2025 Tenstorrent AI ULC
# SPDX-License-Identifier: Apache-2.0

description: Tenstorrent Blackhole PLL

compatible: "tenstorrent,bh-clock-control"

include: [clock-controller.yaml, base.yaml]

properties:
  reg:
    type: array
    required: true

  "#clock-cells":
    const: 0

  refdiv:
    type: int
    required: true
  postdiv:
    type: int
    required: true
  fbdiv:
    type: int
    required: true
  ctrl_bus1:
    type: int
    required: true
  ctrl_bus5:
    type: int
    required: true
  post_divs:
    type: array
    required: true
  use_post_divs:
    type: array
    required: true
```

## dts/bindings/clock/tenstorrent,clock-control-emul.yaml
```yaml
# Copyright (c) 2025 Tenstorrent AI ULC
# SPDX-License-Identifier: Apache-2.0

description: Clock control emulation driver for testing

compatible: "tenstorrent,clock-control-emul"

include: base.yaml

properties:
  default-rate:
    type: int
    default: 1000000000
    description: Default clock rate in Hz (1 GHz default)
```

## dts/bindings/clock/tenstorrent,grendel-clock-control.yaml
```yaml
# Copyright (c) 2026 Tenstorrent AI ULC
# SPDX-License-Identifier: Apache-2.0

description: |
  Tenstorrent Grendel CGM

compatible: "tenstorrent,grendel-clock-control"

include: [clock-controller.yaml, base.yaml]

properties:
  reg:
    type: array
    required: true

  "#clock-cells":
    const: 0

  max-frequency:
    type: int
    required: false
    description: |
      Maximum output frequency in MHz.

  clocks:
    required: true
    description: |
      Phandle to the reference clock.
```

## dts/bindings/debug/tenstorrent,bh-chip-debug-trace.yaml
```yaml
# Copyright (c) 2025 Tenstorrent AI ULC
# SPDX-License-Identifier: Apache-2.0

compatible: "tenstorrent,bh-chip-debug-trace"

description: |
  Tenstorrent Blackhole Chip Debug Trace

include: base.yaml

properties:
  reg:
    required: true
```

## dts/bindings/dma/snps,designware-dma-arc-hs.yaml
```yaml
# Copyright (c) 2025 Tenstorrent AI ULC
# SPDX-License-Identifier: Apache-2.0

description: |
  Synopsys Designware ARC DMA Controller

compatible: "snps,designware-dma-arc-hs"

include: [dma-controller.yaml]

properties:
  "#dma-cells":
    const: 1

  dma-buf-addr-alignment:
    type: int
    default: 32
    description: |
      Memory address alignment requirement for DMA buffers used by the controller.

  dma-channels:
    type: int
    default: 1
    description: |
      Number of DMA channels supported by the DMA server.

  dma-descriptors:
    type: int
    default: 32
    description: |
      Number of DMA descriptors supported by the DMA server.

  max-burst-size:
    type: int
    default: 4
    description: |
      Maximum burst size supported by the DMA server.

  max-pending-transactions:
    type: int
    default: 4
    description: |
      Maximum number of pending bus transactions supported by the DMA server.

  buffer-size:
    type: int
    default: 16
    description: |
      DMA server data buffer size in word entries.

  coherency-support:
    type: boolean
    description: |
      Enable coherency check for all L1 caches within the cluster by hardware.
```

## dts/bindings/dma/snps,designware-dma-arc.yaml
```yaml
# Copyright (c) 2025 Tenstorrent AI ULC
# SPDX-License-Identifier: Apache-2.0

description: |
  Synopsys Designware ARC DMA Controller

compatible: "snps,designware-dma-arc"

include: [dma-controller.yaml]

properties:
  reg:
    required: true

  interrupts:
    required: false

  "#dma-cells":
    const: 1

  dma-channels:
    type: int
    default: 1
    enum: [1, 4, 8, 16]
    description: |
      Number of DMA channels supported by the DMA server.
      Valid values are 1, 4, 8, or 16.

  dma-descriptors:
    type: int
    default: 32
    enum: [32, 64, 128, 256]
    description: |
      Number of DMA descriptors supported by the DMA server.
      Valid values are 32, 64, 128, or 256.

  max-burst-size:
    type: int
    default: 4
    enum: [4, 8, 16]
    description: |
      Maximum burst size supported by the DMA server.
      Valid values are 4, 8, or 16.

  max-pending-transactions:
    type: int
    default: 4
    enum: [4, 8, 16, 32]
    description: |
      Maximum number of pending bus transactions supported by the DMA server.
      Valid values are 4, 8, 16, or 32.

  buffer-size:
    type: int
    default: 16
    enum: [16, 32, 64, 128]
    description: |
      DMA server data buffer size in word entries.
      Valid values are 16, 32, 64, or 128.

  coherency-support:
    type: boolean
    description: |
      Enable coherency check for all L1 caches within the cluster by hardware.
```

## dts/bindings/dma/tenstorrent,bh-arc-dma.yaml
```yaml
# Copyright (c) 2025 Tenstorrent AI ULC
# SPDX-License-Identifier: Apache-2.0

description: |
  Tenstorrent Blackhole ARC DMA controller.

compatible: "tenstorrent,bh-arc-dma"

include: base.yaml

properties:
  reg:
    required: true
```

## dts/bindings/dma/tenstorrent,grendel-smc-dma.yaml
```yaml
# Copyright (c) 2026 Tenstorrent AI ULC
# SPDX-License-Identifier: Apache-2.0

compatible: "tenstorrent,grendel-smc-dma"
include: [dma-controller.yaml, base.yaml]

description: |
  Tenstorrent Grendel SMC DMA Controller.

properties:
  reg:
    required: true

  "#dma-cells":
    const: 1

dma-cells:
  - channel
```

## dts/bindings/dma/tenstorrent,noc-dma.yaml
```yaml
# Copyright (c) 2025 Tenstorrent AI ULC
# SPDX-License-Identifier: Apache-2.0

compatible: "tenstorrent,noc-dma"
include: [dma-controller.yaml]

description: |
  Tenstorrent Network-on-Chip (NOC) DMA Controller

properties:

  dma-buf-addr-alignment:
    type: int
    default: 64
    description: |
      Memory address alignment requirement for DMA buffers used by the controller.
```

## dts/bindings/ethernet/tenstorrent,bh-eth.yaml
```yaml
# Copyright (c) 2025 Tenstorrent AI ULC
# SPDX-License-Identifier: Apache-2.0

compatible: "tenstorrent,bh-eth"

description: |
  Tenstorrent Blackhole Ethernet Controller

include: ["ethernet-controller.yaml", "base.yaml"]

properties: {}
```

## dts/bindings/flash_controller/tenstorrent,stm32-flash-wrapper.yaml
```yaml
# Copyright (c) 2025 Tenstorrent AI ULC
# SPDX-License-Identifier: Apache-2.0

description: |
  Tenstorrent STM32 Family flash controller wrapper. Required to fake
  the flash page size to 4KB for MCUs with 2K pages.

compatible: "tenstorrent,stm32-flash-wrapper"

include: [flash-controller.yaml, soc-nv-flash.yaml]

properties:
  flash-device:
    type: phandle
    description: |
      This property should point to an instance of a flash controller
      compatible with "st,stm32-flash-controller".
    required: true
  page-size:
    type: int
    description: |
      This property defines the flash page size in bytes. The driver
      will report this value instead of the one provided by the
      underlying flash controller.
    required: true
```

## dts/bindings/gpio/tenstorrent,bh-gpio.yaml
```yaml
# Copyright (c) 2025 Tenstorrent AI ULC
# SPDX-License-Identifier: Apache-2.0

description: Tenstorrent Blackhole GPIO

compatible: "tenstorrent,bh-gpio"

include: [gpio-controller.yaml, base.yaml]

properties:
  reg:
    required: true

  ngpios:
    type: int
    required: true

  "#gpio-cells":
    const: 2

gpio-cells:
  - pin
  - flags
```

## dts/bindings/gpio/tenstorrent,grendel-gpio.yaml
```yaml
# Copyright (c) 2025 Tenstorrent AI ULC
# SPDX-License-Identifier: Apache-2.0

description: Tenstorrent Grendel GPIO

compatible: "tenstorrent,grendel-gpio"

include: [gpio-controller.yaml, base.yaml]

properties:
  reg:
    required: true

  "#gpio-cells":
    const: 2

gpio-cells:
  - pin
  - flags
```

## dts/bindings/i2c/tenstorrent,bh-i2c.yaml
```yaml
# Copyright (c) 2025 Tenstorrent AI ULC
# SPDX-License-Identifier: Apache-2.0

compatible: "tenstorrent,bh-i2c"

description: |
  Tenstorrent Blackhole I2C controller.

include: base.yaml

properties:
  dw-i2c-dev:
    type: phandle
    required: true
    description: |
      DesignWare i2c device

  padcntl-reg:
    # Note: this may be expanded to array later to accommodate 64-bit access
    type: int
    required: true
    description: |
      Pad control register for SDA and SCL pins

  paddata-reg:
    # Note: this may be expanded to array later to accommodate 64-bit access
    type: int
    required: true
    description: |
      Pad data register for SDA and SCL pins
```

## dts/bindings/mbox/tenstorrent,grendel-mbox.yaml
```yaml
# Copyright (c) 2026 Tenstorrent AI ULC
# SPDX-License-Identifier: Apache-2.0

description: Tenstorrent Grendel Mailbox

compatible: "tenstorrent,grendel-mbox"

include: [base.yaml, mailbox-controller.yaml]

properties:
  reg:
    required: true

  interrupts:
    required: true

  channel-pairs:
    type: int
    required: true
    description: |
      The number of outbound/inbound channel pairs supported by the mailbox
      controller. The total number of channels is twice this value.

mbox-cells:
  - channel
```

## dts/bindings/memory-controllers/tenstorrent,bh-ddr-memc.yaml
```yaml
# Copyright (c) 2025 Tenstorrent AI ULC
# SPDX-License-Identifier: Apache-2.0

description: |
  Tenstorrent Blackhole DDR memory controller.

compatible: "tenstorrent,bh-ddr-memc"

include: base.yaml

properties:
  reg:
    required: true
```
