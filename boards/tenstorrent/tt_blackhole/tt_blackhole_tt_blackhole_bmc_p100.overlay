/*
 * Copyright (c) 2024 Tenstorrent AI ULC
 *
 * SPDX-License-Identifier: Apache-2.0
 */

&jtag0 {
	tck-gpios = <&gpiob 8 GPIO_ACTIVE_HIGH>;
	tdi-gpios = <&gpiod 3 GPIO_ACTIVE_HIGH>;
	tdo-gpios = <&gpiod 2 GPIO_ACTIVE_HIGH>;
	tms-gpios = <&gpiob 9 GPIO_ACTIVE_HIGH>;
	trst-gpios = <&gpiod 0 GPIO_ACTIVE_LOW>;
};

&flash1 {
	jedec-id = [2c 5b 1a];
};

&ina228 {
	status = "disabled";
};
