/*
 * Copyright (c) 2024 Tenstorrent AI ULC
 *
 * SPDX-License-Identifier: Apache-2.0
 */

#include <zephyr/dt-bindings/pinctrl/tt_blackhole_smc-pinctrl.h>

&pinctrl {
	/* UART0 */
	/omit-if-no-ref/ uart0_tx_default: uart0_tx_default {
		pinmux = <TT_BH_PINMUX(A, 51, UART0_TX)>;
		bias-disable;
	};

	/omit-if-no-ref/ uart0_rx_default: uart0_rx_default {
		pinmux = <TT_BH_PINMUX(B, 15, UART0_RX)>;
		bias-disable;
		input-enable;
	};
};
