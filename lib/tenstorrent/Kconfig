## soc/tenstorrent/tt_blackhole/Kconfig.soc
```kconfig
# Copyright (c) 2024 Tenstorrent AI ULC
# SPDX-License-Identifier: Apache-2.0

config SOC_TT_BLACKHOLE
	bool
	help
	  Tenstorrent Blackhole SoC

config SOC_TT_BLACKHOLE_DMC
	bool
	select SOC_SERIES_STM32G0X
	select SOC_STM32G0B1XX
	help
	  Tenstorrent Blackhole DMC

config SOC_TT_BLACKHOLE_SMC
	bool
	select SOC_TT_BLACKHOLE
	help
	  Tenstorrent Blackhole SMC cluster

config SOC
	default "tt_blackhole" if SOC_TT_BLACKHOLE
```

## soc/tenstorrent/tt_grendel/Kconfig.defconfig
```kconfig
# Copyright (c) 2025 Tenstorrent AI ULC
# SPDX-License-Identifier: Apache-2.0

if SOC_FAMILY_TT_GRENDEL

rsource "*/Kconfig.defconfig"

endif # SOC_FAMILY_TT_GRENDEL
```
