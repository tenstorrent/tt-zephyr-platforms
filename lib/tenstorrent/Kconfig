## lib/tenstorrent/Kconfig
```kconfig
# Copyright (c) 2024 Tenstorrent AI ULC
# SPDX-License-Identifier: Apache-2.0

rsource "banner/Kconfig"
rsource "bh_arc/Kconfig"
rsource "bist/Kconfig"
rsource "boot_fs/Kconfig"
rsource "fwupdate/Kconfig"
rsource "jtag_bootrom/Kconfig"
rsource "bh_chip/Kconfig"
```

## lib/tenstorrent/banner/Kconfig
```kconfig
# Copyright (c) 2024 Tenstorrent AI ULC
# SPDX-License-Identifier: Apache-2.0

config TT_BOOT_BANNER
	bool "Print Tenstorrent's boot banner"
	depends on !BOOT_BANNER
	select PRINTK
	select EARLY_CONSOLE
	help
	  Print Tenstorrent's boot banner instead of Zephyr's boot banner.

if TT_BOOT_BANNER

config TT_BOOT_BANNER_SDK_VERSION
	bool "Print the sdk revision when displaying the boot banner"
	help
	  Print the SDK revision used when displaying the boot banner

endif
```

## lib/tenstorrent/bh_arc/Kconfig
```kconfig
# Copyright (c) 2024 Tenstorrent AI ULC
# SPDX-License-Identifier: Apache-2.0

config TT_BH_ARC
	bool "Blackhole ARC firmware library"
	depends on NANOPB
	# Enable flash driver
	select FLASH
	select FLASH_PAGE_LAYOUT
	# this is a hack
	default y if BOARD_TT_BLACKHOLE_TT_BLACKHOLE_SMC
	help
	  This option enables the Blackhole ARC firmware library.

if TT_BH_ARC

config TT_BH_ARC_NUM_MSG_CODES
	int "Number of message codes"
	default 194
	help
	  The number of message codes

config TT_BH_ARC_FAN_CTRL_ALPHA
	int "Fan control alpha value"
	default 50
	help
	  Value of alpha for filtering fan curve input temp

config TT_BH_ARC_FAN_CTRL_GDDR_TEMP
	bool "Use GDDR temp as fan curve input"
	default y
	help
	  Enable to use GDDR temp in fan speed calculation

config TT_BH_ARC_I2C_TIMEOUT
	bool "Time out if I2C transaction exceeds given duration"
	default y
	help
	  Timeout if I2C transaction exceeds set duration. This can be useful
	  to recover from bus stalls. If the TX FIFO for the I2C controller
	  remains full for this timeout, the I2C controller will attempt to
	  recover the bus by sending 16 SCL pulses while holding SDA low.

config TT_BH_ARC_I2C_TIMEOUT_DURATION
	int "Timeout for I2C transactions in milliseconds"
	default 25
	depends on TT_BH_ARC_I2C_TIMEOUT
	help
	  Timeout for I2C transactions in milliseconds. If the TX FIFO for the I2C controller
	  remains full for this timeout, the I2C controller will attempt to recover the bus by
	  sending 16 SCL pulses while holding SDA low.

config TT_SMC_RECOVERY
	bool "build smc recovery image"
	help
	  Enable to build smc recovery image.

config TT_BH_ARC_WDT_FEED_INTERVAL
	int "Feed interval for watchdog (ms)"
	default 250
	help
	  Interval to feed watchdog within firmware

config TT_BH_ARC_SCRATCHPAD_SIZE
	hex "Size of scratchpad memory in bytes"
	default 0x9000
	help
	  Size of scratchpad memory in bytes. This is mainly used as a temporary buffer for
	  loading images from SPI flash. The size can be further reduced if we are able to
	  load images in smaller chunks. The default size is 0x9000 bytes, which is enough to
	  load the largest image (ERISC FW) in one go. If using a dynamically allocated
	  buffer is possible, then we can remove the statically allocated buffer entirely.
	  If not, the size would likely only be able to be reduced down to 1 page (4096 bytes).

endif
```

## lib/tenstorrent/bh_chip/Kconfig
```kconfig
# Copyright (c) 2024 Tenstorrent AI ULC
# SPDX-License-Identifier: Apache-2.0

config TT_BH_CHIP
	bool "Use the high level bh_chip abstraction"
	depends on JTAG
	depends on GPIO
	help
		Enable the high level bh_chip abstraction

if TT_BH_CHIP

config TT_I2C_STRAP_INIT_PRIORITY
	int "Initialization priority for I2C strapping"
	default 40
	help
	  Priority for I2C strap initialization. This should be set
	  to initialize before the I2C bus, so that GPIO expanders used
	  for strapping can be properly configured during system boot

module = TT_BH_CHIP
module-str = BH Chip API
source "subsys/logging/Kconfig.template.log_config"

endif # TT_BH_CHIP
```

## lib/tenstorrent/bindesc/Kconfig
```kconfig
# Copyright (c) 2026 Tenstorrent AI ULC
# SPDX-License-Identifier: Apache-2.0

config TT_BINDESC
	bool "Tenstorrent Bindesc Extensions"
	depends on BINDESC
	help
	  Tenstorrent's Extensions to Zephyr's Bindesc Library.
```

## lib/tenstorrent/bist/Kconfig
```kconfig
# Copyright (c) 2025 Tenstorrent AI ULC
# SPDX-License-Identifier: Apache-2.0

config TT_BIST
	bool "Tenstorrent Built-in Self Test (BIST)"
	help
	  Tenstorrent's built-in self test (BIST) library.

if TT_BIST

module = TT_BIST
module-str = "Tenstorrent firmware bist"
source "${ZEPHYR_BASE}/subsys/logging/Kconfig.template.log_config"

endif
```

## lib/tenstorrent/bm_event/Kconfig
```kconfig
# Copyright (c) 2024 Tenstorrent AI ULC
# SPDX-License-Identifier: Apache-2.0

config TT_BM_EVENT
	bool "BM event support"
	depends on EVENTS
	help
	  BM event support.

module = TT_BM_EVENT
module-str = TT BM event
source "subsys/logging/Kconfig.template.log_config"
```

## lib/tenstorrent/boot_fs/Kconfig
```kconfig
# Copyright (c) 2024 Tenstorrent AI ULC
# SPDX-License-Identifier: Apache-2.0

config TT_BOOT_FS
	bool "Tenstorrent boot filesystem library"
	help
	  Library for interacting with the boot filesystem.

if TT_BOOT_FS

config TT_BOOT_FS_IMAGE_COUNT_MAX
	int "Maximum number of filesystem images"
	default 10
	help
	  Maximum number of filesystem images.

endif
```

## lib/tenstorrent/event/Kconfig
```kconfig
# Copyright (c) 2024 Tenstorrent AI ULC
# SPDX-License-Identifier: Apache-2.0

config TT_EVENT
	bool "Tenstorrent event support"
	depends on EVENTS
	help
	  Tenstorrent event support. This is a simple wrapper around the k_event API with predefined
	  events specific to Tenstorrent products. It is useful for local dispatching independent
	  events accumulated from software and hardware sources to event handlers that may or may not
	  operate in parallel or in sequence. Like the k_event API, events are not queued; they are
	  either pending or not pending and maybe be combined together as a bitmask.

module = TT_EVENT
module-str = TT Event
source "subsys/logging/Kconfig.template.log_config"
```

## lib/tenstorrent/fan_ctrl/Kconfig
```kconfig
# Copyright (c) 2024 Tenstorrent AI ULC
# SPDX-License-Identifier: Apache-2.0

config TT_FAN_CTRL
	bool "Communicate with MAX6639 fan controller"
	help
	  Communicate with MAX6639 fan controller.

module = TT_FAN_CTRL
module-str = TT Fan Control
source "subsys/logging/Kconfig.template.log_config"
```

## lib/tenstorrent/fw_table/Kconfig
```kconfig
# Copyright (c) 2025 Tenstorrent AI ULC
# SPDX-License-Identifier: Apache-2.0

config TT_FW_TABLE
	bool "Tenstorrent firmware table library"
	depends on TT_BOOT_FS
	depends on NANOPB
	help
	  Library for reading flash resident firmware tables, used for
	  configuration of Tenstorrent devices
```

## lib/tenstorrent/fwupdate/Kconfig
```kconfig
# Copyright (c) 2024 Tenstorrent AI ULC
# SPDX-License-Identifier: Apache-2.0

config TT_FWUPDATE
	bool "Tenstorrent firmware update library"
	depends on IMG_MANAGER
	depends on TT_BOOT_FS
	# maybe imply REBOOT?
	help
	  Library for initiating firmware updates from the application.

if TT_FWUPDATE

config TT_FWUPDATE_WRITE_BUF_SIZE
	hex "Tenstorrent firmware update write buffer size"
	default 0x80 # 128 bytes
	help
	  Should be large enough to not incur a syscall penalty when copying data to / from flash,
	  but small enough so that it doesn't consume too much space in the .data section.

config TT_FWUPDATE_TEST
	bool "Tenstorrent firmware update testing"
	# do not enable this for real hw
	depends on BOARD_QEMU_X86
	help
	  Support creating a test tt_boot_fw filesystem.

module = TT_FWUPDATE
module-str = "Tenstorrent firmware update library"
source "${ZEPHYR_BASE}/subsys/logging/Kconfig.template.log_config"

endif
```

## lib/tenstorrent/jtag_bootrom/Kconfig
```kconfig
# Copyright (c) 2024 Tenstorrent AI ULC
# SPDX-License-Identifier: Apache-2.0

config TT_JTAG_BOOTROM
	bool "Use JTAG to load bootrom"
	depends on JTAG
	depends on TT_BH_CHIP
	depends on GPIO
	depends on TT_BM_EVENT
	help
	  Use JTAG to load bootrom.

if TT_JTAG_BOOTROM

config JTAG_VERIFY_WRITE
	bool "Verify data written over AXI matches the bootrom"
	help
	  Verify data written over AXI.

config JTAG_PROFILE_FUNCTIONS
	bool "Profile JTAG functions"
	help
	  Print the cycle count at the beginning and end of each function.

config JTAG_LOAD_ON_PRESET
	bool "Do not load the workaround during startup, instead wait for the preset line to toggle"
	help
	  Wait for preset to load workaround

config JTAG_LOAD_BOOTROM
	bool "Skip bootrom load, skill deassert resets; used primarily to debug while loading arc_fw"
	default y
	help
	  Skip bootrom load, only deassert resets

module = TT_JTAG_BOOTROM
module-str = JTAG Bootrom Loader
source "subsys/logging/Kconfig.template.log_config"

endif # TT_JTAG_BOOTROM
```

## lib/tenstorrent/log_ringbuf/Kconfig
```kconfig
# Copyright (c) 2025 Tenstorrent AI ULC
# SPDX-License-Identifier: Apache-2.0

config LOG_BACKEND_RINGBUF
	bool "Log data into a ring buffer"
	depends on LOG
	help
	  Library for logging data into a ring buffer. Data can be read from
	  the ring buffer via a custom API, `log_backend_ringbuf_get_data()`.

if LOG_BACKEND_RINGBUF

config LOG_BACKEND_RINGBUF_BUFFER_SIZE
	int "Ring buffer log buffer size"
	default 512
	help
	  Size of the buffer (in bytes) used to store log messages.
	  If the buffer is full, the logging thread will be blocked until
	  space is available in the buffer.

choice LOG_BACKEND_RINGBUF_MODE
	prompt "Logger behavior"
	default LOG_BACKEND_RINGBUF_MODE_BLOCK
	help
	  Choose how the ring buffer logging backend should behave when
	  the buffer is full.
	  BLOCK: Block the logging thread until space is available in the buffer.
	  DROP: Drop new messages if there is no space in the buffer.
	  OVERWRITE: Overwrite old messages in the buffer with new messages.
	  Note that if DROP or OVERWRITE are selected, log messages may be lost.

config LOG_BACKEND_RINGBUF_MODE_BLOCK
	bool "Block logging thread when buffer is full"
	help
	  If there is not enough space in the buffer for a message,
	  block the logging thread until space is available.
	  This is the safest option, as no log messages will be lost,
	  but it may hang logging if the buffer is not read frequently enough.

config LOG_BACKEND_RINGBUF_MODE_DROP
	bool "Drop messages that do not fit in buffer"
	help
	  If there is not enough space in the buffer for a message,
	  drop the new message.

config LOG_BACKEND_RINGBUF_MODE_OVERWRITE
	bool "Overwrite old messages if buffer full"
	help
	  If there is not enough space in the buffer for a message,
	  clear the buffer and write the new message to the front.
	  This may result in loss of old log messages.

endchoice


backend = RINGBUF
backend-str = ringbuf
source "subsys/logging/Kconfig.template.log_format_config"

endif # LOG_BACKEND_RINGBUF
```

## lib/tenstorrent/log_tt_virt/Kconfig
```kconfig
# Copyright (c) 2025 Tenstorrent AI ULC
# SPDX-License-Identifier: Apache-2.0

if LOG

config LOG_BACKEND_TT_VIRT
	bool "Enable Tenstorrent virtual logging backend"
	help
	  Enable logging backend that outputs logs via Tenstorrent virtual
	  interface, used in pre-silicon and simulation environments.

backend = TT_VIRT
backend-str = tt_virt
source "subsys/logging/Kconfig.template.log_format_config"

endif # LOG
```

## lib/tenstorrent/occp/Kconfig
```kconfig
# Copyright (c) 2026 Tenstorrent AI ULC
# SPDX-License-Identifier: Apache-2.0

config OCCP
	bool "OCCP Subsystem"
	select CRC # Required for header checksum calculations
	help
	  Enable support for the OCCP (Open Chiplet Configuration Protocol)
	  subsystem

if OCCP

choice OCCP_BACKEND
	prompt "OCCP Backend"
	default OCCP_BACKEND_I3C

config OCCP_BACKEND_I3C
	bool "I3C Backend"
	select I3C
	help
	  Use the I3C-based OCCP backend, which communicates with a remote
	  OCCP target over the I3C bus.

endchoice

if OCCP_BACKEND_I3C

config OCCP_I3C_READ_TIMEOUT_MS
	int "OCCP I3C Read Timeout (ms)"
	default 5000
	help
	  Set the timeout for I3C read operations in the OCCP I3C backend. If a read
	  operation takes longer than this value, it will be aborted and an error will
	  be returned.
	  Note this timeout is currently very long to support running in
	  simulation environments

endif # OCCP_BACKEND_I3C

module = OCCP
module-str = occp
source "subsys/logging/Kconfig.template.log_config"

endif # OCCP
```

## lib/tenstorrent/qsfp_dd/Kconfig
```kconfig
# Copyright (c) 2025 Tenstorrent AI ULC
# SPDX-License-Identifier: Apache-2.0

config TT_QSFP_DD
	bool "Communicate with QSFP-DD module and GPIO expander"
	help
	  Communicate with QSFP-DD module and GPIO expander.

module = TT_QSFP_DD
module-str = TT QSFP DD
source "subsys/logging/Kconfig.template.log_config"
```

## samples/boards/tt_blackhole/vuart/sample.yaml
```yaml
sample:
  description: Tenstorrent Blackhole Chip Management Firmware
  name: virtual pcie uart
common:
  platform_allow:
    - tt_blackhole@p100/tt_blackhole/smc
    - tt_blackhole@p100a/tt_blackhole/smc
    - tt_blackhole@p150a/tt_blackhole/smc
tests:
  boards.tt_blackhole.vuart:
    build_only: true
```

## samples/drivers/flash/performance/sample.yaml
```yaml
sample:
  description: Flash performance test
  name: Flash Performance Test
common:
  tags: smoke
  integration_platforms:
    - tt_blackhole@p100/tt_blackhole/smc
  harness: console
  harness_config:
    type: one_line
    regex:
      - "Flash performance test complete"
tests:
  sample.drivers.flash.performance: {}
```

## soc/tenstorrent/tt_blackhole/Kconfig
```kconfig
# Copyright (c) 2024 Tenstorrent AI ULC
# SPDX-License-Identifier: Apache-2.0

config SOC_TT_BLACKHOLE_SMC
	select ARC
	select CPU_HAS_FPU
	select MULTI_LEVEL_INTERRUPTS
	select 2ND_LEVEL_INTERRUPTS
	select HAS_SEGGER_RTT if ZEPHYR_SEGGER_MODULE
```

## soc/tenstorrent/tt_blackhole/Kconfig.defconfig
```kconfig
# Copyright (c) 2024 Tenstorrent AI ULC
# SPDX-License-Identifier: Apache-2.0

if SOC_TT_BLACKHOLE

rsource "Kconfig.defconfig.tt_blackhole*"

endif
```

## soc/tenstorrent/tt_blackhole/Kconfig.defconfig.tt_blackhole_dmc
```kconfig
# Copyright (c) 2024 Tenstorrent AI ULC
# SPDX-License-Identifier: Apache-2.0

if SOC_TT_BLACKHOLE_DMC

source "${ZEPHYR_BASE}/soc/st/stm32/stm32g0x/Kconfig.defconfig.stm32g0b1xx"

endif # SOC_TT_BLACKHOLE_DMC
```

## soc/tenstorrent/tt_blackhole/Kconfig.defconfig.tt_blackhole_smc
```kconfig
# Copyright (c) 2024 Tenstorrent AI ULC
# SPDX-License-Identifier: Apache-2.0

if SOC_TT_BLACKHOLE_SMC

config CPU_HS4X
	default y

config NUM_IRQ_PRIO_LEVELS
	# This processor supports 2 priority levels:
	# 0 for Fast Interrupts (FIRQs) and 1 for Regular Interrupts (IRQs).
	default 2

config MAX_IRQ_PER_AGGREGATOR
	# must be > the highest interrupt number used
	default 48

config NUM_IRQS
	# must be > the highest interrupt number used
	# 142 builtin interrupts + 4 aggregators (48 each) = 334
	range 17 512
	default 334

config RGF_NUM_BANKS
	default 1

config SYS_CLOCK_HW_CYCLES_PER_SEC
	default 800000000

config CODE_DENSITY
	default y

config ARCV2_TIMER_IRQ_PRIORITY
	default 1

#config ARC_CONNECT
#	default y

#config IDU_NUM_IRQS
#	default 8

config MP_MAX_NUM_CPUS
	default 1

config ARC_EARLY_SOC_INIT
	default y

config SPI_DW
	default y if SPI

# SPI DW instance requires word aligned access
config SPI_DW_ACCESS_WORD_ONLY
	default y if SPI_DW

config 2ND_LVL_ISR_TBL_OFFSET
	default 142

config NUM_2ND_LEVEL_AGGREGATORS
	default 4

config 2ND_LVL_INTR_00_OFFSET
	default 33

config 2ND_LVL_INTR_01_OFFSET
	default 34

config 2ND_LVL_INTR_02_OFFSET
	default 35

config 2ND_LVL_INTR_03_OFFSET
	default 36

# Needed for octal SPI. WH doesn't actually have this but BH will.
# config CONFIG_SPI_EXTENDED_MODES
#	default y

# pull in the reset controller driver by default
# config RESET
#	default y

endif # SOC_TT_BLACKHOLE_SMC
```
