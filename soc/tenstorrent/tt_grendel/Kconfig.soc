## test-conf/tests/drivers/gpio/gpio_api_1pin/testcase.yaml
```yaml
common:
  tags:
    - drivers
    - gpio
  depends_on: gpio
tests:
  drivers.gpio.1pin:
    tags: smoke
    platform_allow:
      - tt_blackhole@p100a/tt_blackhole/smc
      - tt_blackhole@p150a/tt_blackhole/smc
      - tt_blackhole@p150b/tt_blackhole/smc
      - tt_blackhole@p300a/tt_blackhole/smc
      - tt_grendel_smc
    extra_args:
      - "platform:tt_blackhole@p100a/tt_blackhole/smc:DTC_OVERLAY_FILE=\
         ../../../../../tt-zephyr-platforms/test-conf/tests/drivers/gpio/gpio_api_1pin/\
         boards/tt_blackhole_tt_blackhole_smc.overlay"
      - "platform:tt_blackhole@p150a/tt_blackhole/smc:DTC_OVERLAY_FILE=\
         ../../../../../tt-zephyr-platforms/test-conf/tests/drivers/gpio/gpio_api_1pin/\
         boards/tt_blackhole_tt_blackhole_smc.overlay"
      - "platform:tt_blackhole@p150b/tt_blackhole/smc:DTC_OVERLAY_FILE=\
         ../../../../../tt-zephyr-platforms/test-conf/tests/drivers/gpio/gpio_api_1pin/\
         boards/tt_blackhole_tt_blackhole_smc.overlay"
      - "platform:tt_blackhole@p300a/tt_blackhole/smc:DTC_OVERLAY_FILE=\
         ../../../../../tt-zephyr-platforms/test-conf/tests/drivers/gpio/gpio_api_1pin\
         boards/tt_blackhole_tt_blackhole_smc.overlay"
      - "platform:tt_grendel_smc/tt_grendel_smc:DTC_OVERLAY_FILE=\
         ../../../../../tt-zephyr-platforms/test-conf/tests/drivers/gpio/gpio_api_1pin/\
         boards/tt_grendel_smc.overlay"
    harness_config:
      fixture: gpio_external_pull_down
```

## test-conf/tests/drivers/mbox/mbox_data/boards/tt_mimir_tt_mimir_smc.conf
```kconfig
# Copyright (c) 2026 Tenstorrent AI ULC
# SPDX-License-Identifier: Apache-2.0
CONFIG_MBOX=y
CONFIG_ZTEST_TC_UTIL_USER_OVERRIDE=y
CONFIG_ZTEST=y
CONFIG_TEST_SINGLE_CPU=y
CONFIG_PRINTK=y
```

## test-conf/tests/drivers/mbox/mbox_data/testcase.yaml
```yaml
tests:
  drivers.mbox.mbox_data.grendel:
    tags: smoke
    platform_allow:
      - tt_mimir/tt_mimir/smc
    extra_args:
      - "DTC_OVERLAY_FILE=\
        ../../../../../tt-system-firmware/test-conf/tests/drivers/mbox/mbox_data/\
        boards/tt_mimir_tt_mimir_smc.overlay"
      - "CONF_FILE=\
        ../../../../../tt-system-firmware/test-conf/tests/drivers/mbox/mbox_data/\
        boards/tt_mimir_tt_mimir_smc.conf"
```
