## soc/tenstorrent/tt_grendel/Kconfig.soc
```kconfig
# Copyright (c) 2025 Tenstorrent AI ULC
# SPDX-License-Identifier: Apache-2.0

config SOC_FAMILY_TT_GRENDEL
	bool

config SOC_FAMILY
	default "tt_grendel" if SOC_FAMILY_TT_GRENDEL

rsource "*/Kconfig.soc"
```

## soc/tenstorrent/tt_grendel/tt_grendel_smc/Kconfig
```kconfig
# Copyright (c) 2025 Tenstorrent AI ULC
# SPDX-License-Identifier: Apache-2.0

config SOC_TT_GRENDEL_SMC
	bool
```

## soc/tenstorrent/tt_grendel/tt_grendel_smc/Kconfig.defconfig
```kconfig
# Copyright (c) 2025 Tenstorrent AI ULC
# SPDX-License-Identifier: Apache-2.0

if SOC_TT_GRENDEL_SMC

config SYS_CLOCK_HW_CYCLES_PER_SEC
	default 800000

config NUM_IRQS
	default 213

config MAX_IRQ_PER_AGGREGATOR
	range 0 201
	default 201 # PLIC has 201 interrupts

config MP_MAX_NUM_CPUS
	default 4

config RISCV_SOC_INTERRUPT_INIT
	default y

config 2ND_LVL_ISR_TBL_OFFSET
	default 12

config 2ND_LVL_INTR_00_OFFSET
	default 11

config RISCV_PMP
	default y

endif # SOC_TT_GRENDEL_SMC
```

## soc/tenstorrent/tt_grendel/tt_grendel_smc/Kconfig.soc
```kconfig
# Copyright (c) 2026 Tenstorrent AI ULC
# SPDX-License-Identifier: Apache-2.0

# Grendel SMC SOC- this core should be selected by any SOC that includes
# The Grendel SMC core, but should not be enabled as a standalone SOC option
config TT_GRENDEL_SMC
	bool
	help
	  Tenstorrent Mimir System Management Controller (SMC)
```

## soc/tenstorrent/tt_grendel/tt_mimir/Kconfig.soc
```kconfig
# Copyright (c) 2026 Tenstorrent AI ULC
# SPDX-License-Identifier: Apache-2.0

# Mimir SMC core- quad core RISV-V core based on tenstorrent-rocketcore
config SOC_TT_MIMIR_SMC
	bool
	select SOC_FAMILY_TT_GRENDEL
	select TT_GRENDEL_SMC
	help
	  Tenstorrent Mimir System Management Controller (SMC)

config SOC
	default "tt_mimir" if SOC_TT_MIMIR_SMC
```

## soc/tenstorrent/tt_grendel/tt_rocketcore/Kconfig.defconfig
```kconfig
# Copyright (c) 2025 Tenstorrent AI ULC
# SPDX-License-Identifier: Apache-2.0

if TENSTORRENT_ROCKETCORE

config RISCV_SOC_INTERRUPT_INIT
	default y

config 2ND_LVL_ISR_TBL_OFFSET
	default 12

config 2ND_LVL_INTR_00_OFFSET
	default 11

config NUM_IRQS
	default 128

config MAX_IRQ_PER_AGGREGATOR
	default 82 # PLIC has 82 interrupts

endif # TENSTORRENT_ROCKETCORE
```

## soc/tenstorrent/tt_grendel/tt_rocketcore/Kconfig.soc
```kconfig
# Copyright (c) 2025 Tenstorrent AI ULC
# SPDX-License-Identifier: Apache-2.0

config TENSTORRENT_ROCKETCORE
	bool
```

## subsys/jtag/Kconfig
```kconfig
# Copyright (c) 2018-2019 PHYTEC Messtechnik GmbH
# SPDX-License-Identifier: Apache-2.0

menuconfig JTAG
	bool "JTAG Port support [EXPERIMENTAL]"
	select EXPERIMENTAL
	select JTAG_DRIVER

if JTAG

config JTAG_PACKET_COUNT
	int "Maximum packet buffers for request and response data."
	default 4
	range 1 255
	help
	  Maximum packet buffers for request and response data.

config JTAG_PACKET_SIZE
	int "Maximum packet size for request and response data."
	default 64
	range 64 512
	help
	  Maximum packet size for request and response data.

config JTAG_PROBE_VENDOR
	string "Probe vendor"
	default "Zephyr"

config JTAG_PROBE_NAME
	string "Probe name"
	default "JTAG"

config JTAG_BOARD_VENDOR
	string "Target board vendor"
	default ""

config JTAG_BOARD_NAME
	string "Target board name"
	default ""

config JTAG_DEVICE_VENDOR
	string "Target device vendor"
	default ""

config JTAG_DEVICE_NAME
	string "Target device name"
	default ""

config JTAG_USE_MMAPPED_IO
    bool "Use memory-mapped I/O for JTAG"
    help
      If this option is enabled, the JTAG driver will use memory-mapped I/O
      to access the JTAG hardware. This is the preferred method for most
      systems, but may not be supported on all platforms.

module = JTAG
module-str = jtag
source "subsys/logging/Kconfig.template.log_config"

endif # JTAG
```

## test-conf/samples/hello_world/sample.yaml
```yaml
sample:
  description: Hello World sample, the simplest Zephyr
    application
  name: hello world
common:
  tags:
    - smoke
    - introduction
  integration_platforms:
    - native_sim
  harness: console
  harness_config:
    type: one_line
    regex:
      - "Hello World! (.*)"
tests:
  sample.basic.helloworld.rtt:
    filter: CONFIG_HAS_SEGGER_RTT
    required_snippets:
      - rtt-console
    tags:
      - rtt
```

## test-conf/tests/boot/test_mcuboot/testcase.yaml
```yaml
common:
  sysbuild: true
  tags:
    - mcuboot
    - smoke
  harness: console
  harness_config:
    type: one_line
    regex:
      - "Swapped application booted on (.*)"
tests:
  bootloader.mcuboot.rtt:
    platform_allow:
      - tt_blackhole@p100/tt_blackhole/bmc
      - tt_blackhole@p100a/tt_blackhole/bmc
      - tt_blackhole@p150a/tt_blackhole/bmc
    tags:
      - rtt
    filter: CONFIG_HAS_SEGGER_RTT
    required_snippets:
      - rtt-console
```

## test-conf/tests/drivers/dma/chan_blen_transfer/testcase.yaml
```yaml
tests:
  drivers.dma.chan_blen_transfer:
    min_ram: 16
    tags:
      - dma
      - smoke
    platform_allow:
      - tt_blackhole@p100a/tt_blackhole/smc
      - tt_blackhole@p150a/tt_blackhole/smc
      - tt_blackhole@p150b/tt_blackhole/smc
      - tt_blackhole@p300a/tt_blackhole/smc
    extra_args:
      - "DTC_OVERLAY_FILE=\
         ../../../../../tt-zephyr-platforms/test-conf/tests/drivers/dma/chan_blen_transfer/\
         boards/tt_blackhole_tt_blackhole_smc.overlay;
         ../../../../../tt-zephyr-platforms/test-conf/tests/drivers/dma/chan_blen_transfer/\
        tt_bh_noc.overlay"
      - "EXTRA_CONF_FILE=\
         ../../../../../tt-zephyr-platforms/test-conf/tests/drivers/dma/chan_blen_transfer/\
         boards/tt_blackhole_tt_blackhole_smc.conf;
         ../../../../../tt-zephyr-platforms/test-conf/tests/drivers/dma/chan_blen_transfer/\
         tt_bh_noc.conf"
```

## test-conf/tests/drivers/dma/chan_link_transfer/testcase.yaml
```yaml
common:
  tags:
    - smoke
    - dma
  platform_allow:
    - tt_blackhole@p100a/tt_blackhole/smc
    - tt_blackhole@p150a/tt_blackhole/smc
    - tt_blackhole@p150b/tt_blackhole/smc
    - tt_blackhole@p300a/tt_blackhole/smc
tests:
  drivers.dma.chan_link_transfer.tt_bh_noc:
    extra_args:
      - "DTC_OVERLAY_FILE=\
         ../../../../../tt-zephyr-platforms/test-conf/tests/drivers/dma/chan_link_transfer/\
         tt_bh_noc.overlay"
  drivers.dma.chan_link_transfer.arc_hs:
    extra_args:
      - "DTC_OVERLAY_FILE=\
         ../../../../../tt-zephyr-platforms/test-conf/tests/drivers/dma/chan_link_transfer/\
         arc_hs.overlay"
```

## test-conf/tests/drivers/dma/cyclic/testcase.yaml
```yaml
common:
  tags:
    - dma
tests:
  drivers.dma.cyclic.tt_bh_noc:
    tags:
      - smoke
    skip: true
    platform_allow:
      - tt_blackhole@p100a/tt_blackhole/smc
      - tt_blackhole@p150a/tt_blackhole/smc
      - tt_blackhole@p150b/tt_blackhole/smc
      - tt_blackhole@p300a/tt_blackhole/smc
    extra_args:
      - "DTC_OVERLAY_FILE=\
         ../../../../../tt-zephyr-platforms/test-conf/tests/drivers/dma/cyclic/\
         tt_bh_noc.overlay"
  drivers.dma.cyclic.arc_hs:
    tags:
      - smoke
    skip: true
    platform_allow:
      - tt_blackhole@p100a/tt_blackhole/smc
      - tt_blackhole@p150a/tt_blackhole/smc
      - tt_blackhole@p150b/tt_blackhole/smc
      - tt_blackhole@p300a/tt_blackhole/smc
    extra_args:
      - "DTC_OVERLAY_FILE=\
         ../../../../../tt-zephyr-platforms/test-conf/tests/drivers/dma/cyclic/\
         arc_hs.overlay"
```

## test-conf/tests/drivers/dma/loop_transfer/testcase.yaml
```yaml
common:
  tags:
    - drivers
    - dma
  depends_on: dma
tests:
  drivers.dma.loop_transfer:
    min_ram: 16
    tags:
      - dma
      - smoke
    platform_allow:
      - tt_blackhole@p100a/tt_blackhole/smc
      - tt_blackhole@p150a/tt_blackhole/smc
      - tt_blackhole@p150b/tt_blackhole/smc
      - tt_blackhole@p300a/tt_blackhole/smc
    extra_args:
      - "platform:tt_blackhole@p100a/tt_blackhole/smc:DTC_OVERLAY_FILE=\
         ../../../../../tt-zephyr-platforms/test-conf/tests/drivers/dma/loop_transfer/\
         boards/tt_blackhole_tt_blackhole_smc.overlay"
      - "platform:tt_blackhole@p150a/tt_blackhole/smc:DTC_OVERLAY_FILE=\
         ../../../../../tt-zephyr-platforms/test-conf/tests/drivers/dma/loop_transfer/\
         boards/tt_blackhole_tt_blackhole_smc.overlay"
      - "platform:tt_blackhole@p150b/tt_blackhole/smc:DTC_OVERLAY_FILE=\
         ../../../../../tt-zephyr-platforms/test-conf/tests/drivers/dma/loop_transfer/\
         boards/tt_blackhole_tt_blackhole_smc.overlay"
      - "platform:tt_blackhole@p300a/tt_blackhole/smc:DTC_OVERLAY_FILE=\
         ../../../../../tt-zephyr-platforms/test-conf/tests/drivers/dma/loop_transfer/\
         boards/tt_blackhole_tt_blackhole_smc.overlay"
```

## test-conf/tests/drivers/dma/scatter_gather/testcase.yaml
```yaml
common:
  tags:
    - smoke
    - dma
  platform_allow:
    - tt_blackhole@p100a/tt_blackhole/smc
    - tt_blackhole@p150a/tt_blackhole/smc
    - tt_blackhole@p150b/tt_blackhole/smc
    - tt_blackhole@p300a/tt_blackhole/smc
    - tt_grendel_smc
tests:
  drivers.dma.scatter_gather.tt_grendel_smc:
    extra_args:
      - "DTC_OVERLAY_FILE=\
         ../../../../../tt-system-firmware/test-conf/tests/drivers/dma/scatter_gather/\
         tt_grendel_smc.overlay"
      - "EXTRA_CONF_FILE=\
         ../../../../../tt-system-firmware/test-conf/tests/drivers/dma/scatter_gather/\
         tt_grendel_smc.conf"
  drivers.dma.scatter_gather.tt_bh_noc:
    extra_args:
      - "DTC_OVERLAY_FILE=\
         ../../../../../tt-system-firmware/test-conf/tests/drivers/dma/scatter_gather/\
         tt_bh_noc.overlay"
      - "EXTRA_CONF_FILE=\
         ../../../../../tt-system-firmware/test-conf/tests/drivers/dma/scatter_gather/\
         tt_bh_noc.conf"
  drivers.dma.scatter_gather.arc_hs.interrupts:
    extra_args:
      - "DTC_OVERLAY_FILE=\
         ../../../../../tt-system-firmware/test-conf/tests/drivers/dma/scatter_gather/\
         arc_hs.overlay"
      - "EXTRA_CONF_FILE=\
         ../../../../../tt-system-firmware/test-conf/tests/drivers/dma/scatter_gather/\
         arc_hs.conf"
  drivers.dma.scatter_gather.arc_hs.polling:
    extra_args:
      - "DTC_OVERLAY_FILE=\
         ../../../../../tt-system-firmware/test-conf/tests/drivers/dma/scatter_gather/\
         arc_hs_polling.overlay"
      - "EXTRA_CONF_FILE=\
         ../../../../../tt-system-firmware/test-conf/tests/drivers/dma/scatter_gather/\
         arc_hs.conf"
```

## test-conf/tests/drivers/flash/common/testcase.yaml
```yaml
common:
  tags:
    - drivers
    - flash
tests:
  drivers.flash.common.rtt:
    tags: smoke
    platform_allow:
      - tt_blackhole@p100/tt_blackhole/smc
      - tt_blackhole@p100a/tt_blackhole/smc
      - tt_blackhole@p150a/tt_blackhole/smc
      - tt_blackhole@p300a/tt_blackhole/smc
    extra_configs:
      - CONFIG_SEGGER_RTT_BUFFER_SIZE_UP=4096
    extra_args:
      - "platform:tt_blackhole@p100/tt_blackhole/smc:DTC_OVERLAY_FILE=\
         ../../../../../tt-zephyr-platforms/test-conf/tests/drivers/flash/\
         common/tt_blackhole_tt_blackhole_smc.overlay"
      - "platform:tt_blackhole@p100/tt_blackhole/smc:EXTRA_CONF_FILE=\
         ../../../../../tt-zephyr-platforms/test-conf/tests/drivers/flash/\
         common/tt_blackhole_tt_blackhole_smc.conf"
      - "platform:tt_blackhole@p100a/tt_blackhole/smc:DTC_OVERLAY_FILE=\
         ../../../../../tt-zephyr-platforms/test-conf/tests/drivers/flash/\
         common/tt_blackhole_tt_blackhole_smc.overlay"
      - "platform:tt_blackhole@p100a/tt_blackhole/smc:EXTRA_CONF_FILE=\
         ../../../../../tt-zephyr-platforms/test-conf/tests/drivers/flash/\
         common/tt_blackhole_tt_blackhole_smc.conf"
      - "platform:tt_blackhole@p150a/tt_blackhole/smc:DTC_OVERLAY_FILE=\
         ../../../../../tt-zephyr-platforms/test-conf/tests/drivers/flash/\
         common/tt_blackhole_tt_blackhole_smc.overlay"
      - "platform:tt_blackhole@p150a/tt_blackhole/smc:EXTRA_CONF_FILE=\
         ../../../../../tt-zephyr-platforms/test-conf/tests/drivers/flash/\
         common/tt_blackhole_tt_blackhole_smc.conf"
      - "platform:tt_blackhole@p300a/tt_blackhole/smc:DTC_OVERLAY_FILE=\
         ../../../../../tt-zephyr-platforms/test-conf/tests/drivers/flash/\
         common/tt_blackhole_tt_blackhole_smc.overlay"
      - "platform:tt_blackhole@p300a/tt_blackhole/smc:EXTRA_CONF_FILE=\
         ../../../../../tt-zephyr-platforms/test-conf/tests/drivers/flash/\
         common/tt_blackhole_tt_blackhole_smc.conf"
    required_snippets:
      - rtt-console
```

## test-conf/tests/drivers/gpio/boards/testcase.yaml
```yaml
common:
  tags:
    - drivers
    - gpio
tests:
  drivers.gpio.common.rtt:
    tags: smoke
    platform_allow:
      - tt_blackhole@p100/tt_blackhole/smc
      - tt_blackhole@p100a/tt_blackhole/smc
      - tt_blackhole@p150a/tt_blackhole/smc
      - tt_blackhole@p150b/tt_blackhole/smc
      - tt_blackhole@p300a/tt_blackhole/smc
    extra_configs:
      - CONFIG_GPIO=y
      - CONFIG_GPIO_TT_BH=y
      - CONFIG_SEGGER_RTT_BUFFER_SIZE_UP=4096
    extra_args:
      - "platform:tt_blackhole@p100/tt_blackhole/smc:DTC_OVERLAY_FILE=\
         ../../../../../tt-zephyr-platforms/test-conf/tests/drivers/gpio/\
         boards/tt_blackhole_tt_blackhole_smc.overlay"
      - "platform:tt_blackhole@p100/tt_blackhole/smc:EXTRA_CONF_FILE=\
         ../../../../../tt-zephyr-platforms/test-conf/tests/drivers/gpio/\
         boards/tt_blackhole_tt_blackhole_smc.conf"
      - "platform:tt_blackhole@p100a/tt_blackhole/smc:DTC_OVERLAY_FILE=\
         ../../../../../tt-zephyr-platforms/test-conf/tests/drivers/gpio/\
         boards/tt_blackhole_tt_blackhole_smc.overlay"
      - "platform:tt_blackhole@p100a/tt_blackhole/smc:EXTRA_CONF_FILE=\
         ../../../../../tt-zephyr-platforms/test-conf/tests/drivers/gpio/\
         boards/tt_blackhole_tt_blackhole_smc.conf"
      - "platform:tt_blackhole@p150a/tt_blackhole/smc:DTC_OVERLAY_FILE=\
         ../../../../../tt-zephyr-platforms/test-conf/tests/drivers/gpio/\
         boards/tt_blackhole_tt_blackhole_smc.overlay"
      - "platform:tt_blackhole@p150a/tt_blackhole/smc:EXTRA_CONF_FILE=\
         ../../../../../tt-zephyr-platforms/test-conf/tests/drivers/gpio/\
         boards/tt_blackhole_tt_blackhole_smc.conf"
      - "platform:tt_blackhole@p150b/tt_blackhole/smc:DTC_OVERLAY_FILE=\
         ../../../../../tt-zephyr-platforms/test-conf/tests/drivers/gpio/\
         boards/tt_blackhole_tt_blackhole_smc.overlay"
      - "platform:tt_blackhole@p150b/tt_blackhole/smc:EXTRA_CONF_FILE=\
         ../../../../../tt-zephyr-platforms/test-conf/tests/drivers/gpio/\
         boards/tt_blackhole_tt_blackhole_smc.conf"
      - "platform:tt_blackhole@p300a/tt_blackhole/smc:DTC_OVERLAY_FILE=\
         ../../../../../tt-zephyr-platforms/test-conf/tests/drivers/gpio/\
         boards/tt_blackhole_tt_blackhole_smc.overlay"
      - "platform:tt_blackhole@p300a/tt_blackhole/smc:EXTRA_CONF_FILE=\
         ../../../../../tt-zephyr-platforms/test-conf/tests/drivers/gpio/\
         boards/tt_blackhole_tt_blackhole_smc.conf"
    required_snippets:
      - rtt-console
```

## test-conf/tests/drivers/gpio/gpio_api_1pin/boards/tt_blackhole_tt_blackhole_smc.conf
```kconfig
# Enable RTT
CONFIG_USE_SEGGER_RTT=y
CONFIG_SEGGER_RTT_BUFFER_SIZE_UP=8192

# enable console
CONFIG_CONSOLE=y
CONFIG_RTT_CONSOLE=y

CONFIG_SEGGER_RTT_BUFFER_SIZE_DOWN=128
CONFIG_SEGGER_RTT_PRINTF_BUFFER_SIZE=256
```
