## Kconfig
```kconfig
# Copyright (c) 2024 Tenstorrent AI ULC
# SPDX-License-Identifier: Apache-2.0

rsource "drivers/Kconfig"
rsource "lib/Kconfig"
rsource "subsys/Kconfig"

menu "Tenstorrent App Configuration"

# FIXME: we probably don't need this - main.c already sets variables to NULL if this is not
# selected, and we can just compare the variables in question to NULL in the few conditional
# statements where CONFIG_TT_ASSEMBLY_TEST is used. Moved here because check_compliance.py
# was cranky with it in the app directory.
config TT_ASSEMBLY_TEST
	bool "Output additional debug if we are running in a test environment"

# common log level for applications
module = TT_APP
module-str = "Tenstorrent app"
source "${ZEPHYR_BASE}/subsys/logging/Kconfig.template.log_config"

endmenu
```

## app/tt_blackhole/dmc_rom_update/Kconfig
```kconfig
# Copyright (c) 2025 Tenstorrent AI ULC
# SPDX-License-Identifier: Apache-2.0

# Offset image 0x5000 bytes. First 0x4000 (16 KB) will be used for
# new MCUBoot image. Next 0x200 (512 bytes) is where the new slot0 header
# would reside. By erasing this, we ensure that MCUBoot will bootstrap from
# slot1 (the new image) on next reboot.
# We offset 0x5000 because the flash page size is 0x1000 (4 KB)
config ROM_START_OFFSET
	default 0x5000

source "Kconfig.zephyr"
```

## boards/tenstorrent/blackhole/Kconfig.tt_blackhole
```kconfig
# Copyright (c) 2024 Tenstorrent AI ULC
# SPDX-License-Identifier: Apache-2.0

config BOARD_TT_BLACKHOLE
	select SOC_STM32G0B1XX if BOARD_TT_BLACKHOLE_STM32G0B1XX
	select SOC_TT_BLACKHOLE_SMC if BOARD_TT_BLACKHOLE_TT_BLACKHOLE_SMC
```

## boards/tenstorrent/blackhole/board.yml
```yaml
boards:
- name: tt_blackhole
  full_name: Tenstorrent Blackhole board
  vendor: tenstorrent
  socs:
    - name: stm32g0b1xx
    - name: tt_blackhole
```

## boards/tenstorrent/tt_blackhole/Kconfig
```kconfig
# Copyright (c) 2025 Tenstorrent AI ULC
# SPDX-License-Identifier: Apache-2.0

config FLASH_TRAINING_PRIORITY
	int "Flash training priority"
	default 95
	help
	  Initialization priority for flash training. This is used to train the
	  SSI RX DELAY value for the best reliability. Must be greater than
	  flash and MSPI init priority

config FLASH_RESET_PRIORITY
	int "Flash reset priority"
	default 75
	help
	  Initialization priority for flash reset. This is used to reset the flash
	  before the flash driver runs. Must be greater than MSPI init priority,
	  and less than flash init priority.

if BOARD_TT_BLACKHOLE_TT_BLACKHOLE_SMC

config TT_SRST_ASSIST
	bool "Enable TT SRST assist"
	default y
	help
	  It's safe to enable this option always, but it is mainly required when using JTAG to control
	  Blackhole cards. It requires both a JTAG debugger attached to the SMC as well as an SWD
	  debugger attached to the DMC.

if TT_SRST_ASSIST

config TT_SRST_ASSIST_ADDR
	hex "Address to write to toggle SRST pin(s)"
	# this is the same address on all P100a+ boards
	default 0x50000418
	help
	  This is the address of the GPIO control register on the DMC that controls the SRST pin(s).

config TT_SRST_ASSIST_SET
	hex "Value to write to set SRST pin(s)"
	# GPIOB pin 0
	default 0x10000
	help
	  This is the value to write to the GPIO control register on the DMC to set the SRST pin(s).

config TT_SRST_ASSIST_CLR
	hex "Value to write to set SRST pin(s)"
	# GPIOB pin 0
	default 0x1
	help
	  This is the value to write to the GPIO control register on the DMC to set the SRST pin(s).

endif

endif
```

## boards/tenstorrent/tt_blackhole/Kconfig.defconfig
```kconfig
# Copyright (c) 2025 Tenstorrent AI ULC
# SPDX-License-Identifier: Apache-2.0

if BOARD_TT_BLACKHOLE_TT_BLACKHOLE_DMC

# Use deferred logging for DMC, since it allows us to capture the entirety of ZTest output
# https://github.com/zephyrproject-rtos/zephyr/blob/main/subsys/testsuite/ztest/src/ztest.c#L723
choice LOG_MODE
	# Required for CONFIG_TEST_LOGGING_FLUSH_AFTER_TEST
	default LOG_MODE_DEFERRED
endchoice
choice LOG_BACKEND_RTT_MODE
	# Do not block the logging thread in case of a full buffer, preserve the oldest logs
	default LOG_BACKEND_RTT_MODE_DROP
endchoice

endif

if BOARD_TT_BLACKHOLE_TT_BLACKHOLE_SMC

# Raise the flash init priority, so that we can run flash reset
# after MSPI init but before flash init
config FLASH_INIT_PRIORITY
	default 80 if BOARD_TT_BLACKHOLE_TT_BLACKHOLE_SMC

choice LOG_BACKEND_RTT_MODE
	# Do not block the logging thread in case of a full buffer, preserve the newest logs
	default LOG_BACKEND_RTT_MODE_OVERWRITE
endchoice

endif

# RTT is the primary log backend for devices connected via JTAG or SWD without UARTs
# It is also used for collecting logs from SMC before PCIe enumerates
config LOG_BACKEND_RTT
	default y if LOG
```

## boards/tenstorrent/tt_blackhole/Kconfig.p300
```kconfig
# Copyright (c) 2024 Tenstorrent AI ULC
# SPDX-License-Identifier: Apache-2.0

config BOARD_P300
	select SOC_TT_BLACKHOLE_DMC if BOARD_P300_TT_BLACKHOLE_DMC
	select SOC_TT_BLACKHOLE_SMC if BOARD_TT_BLACKHOLE_TT_BLACKHOLE_SMC
```

## boards/tenstorrent/tt_blackhole/Kconfig.sysbuild
```kconfig
# Copyright (c) 2024 Tenstorrent AI ULC
# SPDX-License-Identifier: Apache-2.0

choice BOOTLOADER
	default BOOTLOADER_NONE
endchoice

choice BOOT_SIGNATURE_TYPE
	# Note: CONFIG_MCUBOOT_SIGNATURE_KEY_FILE must point to an
	# internally-managed RSA key file for production builds.
	default BOOT_SIGNATURE_TYPE_RSA
endchoice
```

## boards/tenstorrent/tt_blackhole/Kconfig.tt_blackhole
```kconfig
# Copyright (c) 2024 Tenstorrent AI ULC
# SPDX-License-Identifier: Apache-2.0

config BOARD_TT_BLACKHOLE
	select SOC_TT_BLACKHOLE_DMC if BOARD_TT_BLACKHOLE_TT_BLACKHOLE_DMC
	select SOC_TT_BLACKHOLE_SMC if BOARD_TT_BLACKHOLE_TT_BLACKHOLE_SMC
```

## boards/tenstorrent/tt_blackhole/board.yml
```yaml
boards:
- name: tt_blackhole
  full_name: Tenstorrent Blackhole board
  vendor: tenstorrent
  revision:
    format: custom
    revisions:
    - name: "p100a"
    - name: "p150a"
    - name: "p150b"
    - name: "p150c"
    - name: "p300a"
    - name: "p300b"
    - name: "p300c"
    - name: "galaxy"
    - name: "galaxy_revc"
  socs:
  - name: tt_blackhole
```

## boards/tenstorrent/tt_blackhole/p300_tt_blackhole_dmc_defconfig
```kconfig
# Copyright (c) 2024 Tenstorrent AI ULC
# SPDX-License-Identifier: Apache-2.0

# Enable RTT
CONFIG_USE_SEGGER_RTT=y

# enable console
CONFIG_CONSOLE=y
CONFIG_RTT_CONSOLE=y

# GPIO Controller
CONFIG_GPIO=y

# Enable Clocks
CONFIG_CLOCK_CONTROL=y

# enable pin controller
CONFIG_PINCTRL=y

# enable i2c
CONFIG_I2C=y

# enable spi
CONFIG_SPI=y

# enable flash
CONFIG_FLASH=y

# enable external spi flash
CONFIG_SPI_NOR=y
CONFIG_SPI_NOR_FLASH_LAYOUT_PAGE_SIZE=4096

# interrupts are not needed for nxp,pca9554a and compatible gpio expanders on Blackhole
CONFIG_GPIO_PCA_SERIES_INTERRUPT=n

# enable MFD, PWM, sensor
CONFIG_MFD=y
CONFIG_PWM=y
CONFIG_SENSOR=y
```

## boards/tenstorrent/tt_blackhole/tt_blackhole_tt_blackhole_smc_defconfig
```kconfig
# Copyright (c) 2024 Tenstorrent AI ULC
# SPDX-License-Identifier: Apache-2.0

# enable console
CONFIG_CONSOLE=y
CONFIG_SERIAL=y
CONFIG_UART_CONSOLE=y
# required for vuart
CONFIG_MAIN_STACK_SIZE=4096
# log backend
CONFIG_USE_SEGGER_RTT=y

# GPIO Controller
# CONFIG_GPIO=y

# Enable Clocks
#CONFIG_CLOCK_CONTROL=y

# Enable PVT sensor
CONFIG_SENSOR=y
CONFIG_RTIO=y
CONFIG_SENSOR_ASYNC_API=y

# enable i2c
CONFIG_I2C=y
CONFIG_I2C_DW_CLOCK_SPEED=50

# enable flash
CONFIG_FLASH=y

# enable external spi flash
CONFIG_FLASH_MSPI_NOR_RUNTIME_PROBE=y

# limit max read/write size to avoid SPI FIFO over/underruns
# Disable waiting between polling attempts to improve performance
CONFIG_FLASH_MSPI_NOR_READ_MAX=11
CONFIG_FLASH_MSPI_NOR_WRITE_MAX=11
CONFIG_FLASH_MSPI_NOR_LIMIT_POLLING=n

# enable the bh_arc library
CONFIG_TT_BH_ARC=y
# BH_ARC will raise system clock frequency, update it here
CONFIG_SYS_CLOCK_HW_CYCLES_PER_SEC=800000000

#enable pll
CONFIG_CLOCK_CONTROL=y
```

## boards/tenstorrent/tt_grendel_mk_bu_dmc/Kconfig.defconfig
```kconfig
# Copyright (c) 2026 Tenstorrent AI ULC
# SPDX-License-Identifier: Apache-2.0

if BOARD_TT_GRENDEL_MK_BU_DMC

config SYS_CLOCK_TICKS_PER_SEC
	default 1000

config SYS_CLOCK_HW_CYCLES_PER_SEC
	default 96000000

endif # BOARD_TT_GRENDEL_MK_BU_DMC
```

## boards/tenstorrent/tt_grendel_mk_bu_dmc/Kconfig.tt_grendel_mk_bu_dmc
```kconfig
# Copyright (c) 2026 Tenstorrent AI ULC
# SPDX-License-Identifier: Apache-2.0

config BOARD_TT_GRENDEL_MK_BU_DMC
	select SOC_STM32U385XX
```

## boards/tenstorrent/tt_grendel_mk_bu_dmc/board.yml
```yaml
board:
  name: tt_grendel_mk_bu_dmc
  full_name: Tenstorrent Grendel MK BU Device Management Controller
  vendor: tenstorrent
  socs:
    - name: stm32u385xx
```

## boards/tenstorrent/tt_grendel_smc/Kconfig.defconfig
```kconfig
# Copyright (c) 2024 Tenstorrent AI ULC
# SPDX-License-Identifier: Apache-2.0

if BOARD_TT_GRENDEL_SMC

config SYS_CLOCK_TICKS_PER_SEC
	default 1000

config SYS_CLOCK_HW_CYCLES_PER_SEC
	default 1000000

if LOG

# Use Tenstorrent virtual logging backend by default on Grendel SMC
config LOG_BACKEND_TT_VIRT
	bool
	default y

# Use immediate logging mode, otherwise logs will often be lost in simulation
choice LOG_MODE
	default LOG_MODE_IMMEDIATE
endchoice

endif

endif # BOARD_TT_GRENDEL_SMC
```

## boards/tenstorrent/tt_grendel_smc/Kconfig.tt_grendel_smc
```kconfig
# Copyright (c) 2024 Tenstorrent AI ULC
# SPDX-License-Identifier: Apache-2.0

config BOARD_TT_GRENDEL_SMC
	select SOC_TT_GRENDEL_SMC
```

## boards/tenstorrent/tt_grendel_smc/board.yml
```yaml
board:
  name: tt_grendel_smc
  full_name: Tenstorrent Grendel System Management Controller
  vendor: tenstorrent
  socs:
    - name: tt_grendel_smc
```

## boards/tenstorrent/tt_grendel_smc/tt_grendel_smc_defconfig
```kconfig
# Copyright (c) 2025 Tenstorrent AI ULC
# SPDX-License-Identifier: Apache-2.0

CONFIG_CONSOLE=y
CONFIG_SERIAL=n
CONFIG_TENSTORRENT_VIRT_CONSOLE=y
CONFIG_XIP=n
# Reduce system clock ticks and hardware cycles, as SMC simulation is slow
# and we don't want to waste simulation time waiting for kernel timeouts.
CONFIG_SYS_CLOCK_TICKS_PER_SEC=50
CONFIG_SYS_CLOCK_HW_CYCLES_PER_SEC=500
# Disable printing the default Zephyr boot banner
CONFIG_BOOT_BANNER=n
# Print the Tenstorrent boot banner + git version on startup
CONFIG_TT_BOOT_BANNER=y
CONFIG_TT_BOOT_BANNER_GIT_VERSION=y
CONFIG_TT_BOOT_BANNER_SDK_VERSION=y
```

## boards/tenstorrent/tt_mimir/Kconfig.tt_mimir
```kconfig
# Copyright (c) 2024 Tenstorrent AI ULC
# SPDX-License-Identifier: Apache-2.0

config BOARD_TT_MIMIR
	select SOC_TT_MIMIR_SMC if BOARD_TT_MIMIR_TT_MIMIR_SMC
```

## boards/tenstorrent/tt_mimir/board.yml
```yaml
board:
  name: tt_mimir
  full_name: Tenstorrent Mimir Board
  vendor: tenstorrent
  socs:
    - name: tt_mimir
```

## drivers/Kconfig
```kconfig
#  Copyright (c) 2024 Tenstorrent AI ULC
#  SPDX-License-Identifier: Apache-2.0

menu "Device Drivers"

# zephyr-keep-sorted-start
rsource "clock_control/Kconfig"
rsource "flash/Kconfig"
rsource "gpio/Kconfig"
rsource "jtag/Kconfig"
rsource "memc/Kconfig"
rsource "mfd/Kconfig"
rsource "misc/Kconfig"
rsource "mspi/Kconfig"
rsource "pinctrl/Kconfig"
rsource "pwm/Kconfig"
rsource "reset/Kconfig"
rsource "sensor/Kconfig"
rsource "serial/Kconfig"
rsource "watchdog/Kconfig"
# zephyr-keep-sorted-stop

endmenu
```

## drivers/avs/Kconfig
```kconfig
# Copyright (c) 2025 Tenstorrent AI ULC
# SPDX-License-Identifier: Apache-2.0

menuconfig AVS
	bool "AVS Drivers"

if AVS

menu "AVS drivers"

# zephyr-keep-sorted-start
rsource "Kconfig.tt_avs"
# zephyr-keep-sorted-stop

endmenu

endif
```

## drivers/avs/Kconfig.tt_avs
```kconfig
# Copyright (c) 2025 Tenstorrent AI ULC
# SPDX-License-Identifier: Apache-2.0

config TT_AVS
	bool "Tenstorrent AVS driver"
	default y
	depends on DT_HAS_TENSTORRENT_AVS_ENABLED
	help
	  Enable the Tenstorrent AVS driver.

config AVS_INIT_PRIORITY
	int "AVS initialization priority"
	default 50
	help
	  Initialization priority of the AVS driver.
```
