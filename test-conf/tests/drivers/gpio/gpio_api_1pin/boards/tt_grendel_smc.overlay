#include <zephyr/dt-bindings/gpio/gpio.h>

/ {
	aliases {
		led0 = &led0;
	};

	/* This gpio isn't routed anywhere, just used for zephyr unit tests */
	leds {
		compatible = "gpio-leds";
		led0: led_0 {
			gpios = <&gpio0 0 GPIO_ACTIVE_HIGH>;
		};
	};
};

