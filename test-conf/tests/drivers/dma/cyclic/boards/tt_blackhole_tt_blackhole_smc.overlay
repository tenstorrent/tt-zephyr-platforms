/*
 * Copyright (c) 2025 Tenstorrent AI ULC
 * SPDX-License-Identifier: Apache-2.0
 */

/*
 * DTS overlay to expose the ARC DMA controller to the cyclic test
 * on the Tenstorrent Blackhole SMC platform.
 */

&dma0 {
	status = "okay";
	dma-channels = <4>;
};
