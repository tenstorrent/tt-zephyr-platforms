/*
 * Copyright (c) 2025 Tenstorrent AI ULC
 * SPDX-License-Identifier: Apache-2.0
 */

&dma0 {
	status = "okay";
	dma-channels = <4>;
};

&dma1 {
	status = "okay";
};

/*
 * added to prevent SRAM overflow errors
 */

&csm {
	reg = <0x10000000 0x40000>;
};
