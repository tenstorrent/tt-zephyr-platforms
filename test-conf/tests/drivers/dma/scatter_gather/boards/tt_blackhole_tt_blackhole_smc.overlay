/*
 * Copyright (c) 2025 Tenstorrent AI ULC
 * SPDX-License-Identifier: Apache-2.0
 */

/*
 * DTS overlay to expose the ARC DMA controller to the scatter_gather test
 * on the Tenstorrent Blackhole SMC platform.
 */

/ {
	aliases {
		dma0 = &dma0;
	};
};

&dma0 {
	status = "okay";
	dma-channels = <4>;
};

tst_dma0: &dma0 { };

/*
 * added to prevent SRAM overflow errors
 */

&csm {
	reg = <0x10000000 0x40000>;
};
