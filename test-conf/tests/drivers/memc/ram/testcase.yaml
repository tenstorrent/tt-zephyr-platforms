## test-conf/tests/drivers/memc/ram/testcase.yaml
```yaml
tests:
  drivers.memc.tt_bh_ddr:
    tags: smoke
    platform_allow:
      - tt_blackhole@p100/tt_blackhole/smc
      - tt_blackhole@p100a/tt_blackhole/smc
      - tt_blackhole@p150a/tt_blackhole/smc
      - tt_blackhole@p300a/tt_blackhole/smc
    extra_args:
      - "DTC_OVERLAY_FILE=\
        ../../../../../tt-zephyr-platforms/test-conf/tests/drivers/memc/ram/\
        memc_tt_bh_ddr.overlay"
      - "CONF_FILE=\
        ../../../../../tt-zephyr-platforms/test-conf/tests/drivers/memc/ram/\
        memc_tt_bh_ddr.conf"
```

## test-conf/tests/drivers/misc/bh_fwtable/boards/tt_blackhole_tt_blackhole_smc.conf
```kconfig
CONFIG_BH_FWTABLE=y

# enable dependencies for the driver to initialize
CONFIG_FLASH=y
CONFIG_FLASH_MAP=y
CONFIG_TT_BOOT_FS=y
```

## test-conf/tests/drivers/pwm/pwm_api/boards/tt_blackhole_tt_blackhole_dmc.conf
```kconfig
# Enable RTT
CONFIG_USE_SEGGER_RTT=y
CONFIG_SEGGER_RTT_BUFFER_SIZE_UP=8192

# enable console
CONFIG_CONSOLE=y
CONFIG_RTT_CONSOLE=y

CONFIG_SEGGER_RTT_BUFFER_SIZE_DOWN=128
CONFIG_SEGGER_RTT_PRINTF_BUFFER_SIZE=256

CONFIG_MFD=y
CONFIG_PWM=y
CONFIG_SENSOR=y

# enable max6639 fan controller
CONFIG_MFD_MAX6639=y
CONFIG_PWM_MAX6639=y
CONFIG_MAX6639_SENSOR=y

# skip zero duty cycle test
CONFIG_SKIP_ZERO_DUTY_CYCLE_TEST=y
```

## test-conf/tests/drivers/pwm/pwm_api/testcase.yaml
```yaml
common:
  tags:
    - drivers
    - pwm
  depends_on: pwm
tests:
  drivers.pwm.api:
    tags: smoke
    platform_allow:
      - tt_blackhole@p150a/tt_blackhole/dmc
    extra_args:
      - "DTC_OVERLAY_FILE=\
         ../../../../../tt-zephyr-platforms/test-conf/tests/drivers/pwm/pwm_api/\
         boards/tt_blackhole_tt_blackhole_dmc.overlay"
      - "EXTRA_CONF_FILE=\
         ../../../../../tt-zephyr-platforms/test-conf/tests/drivers/pwm/pwm_api/\
         boards/tt_blackhole_tt_blackhole_dmc.conf"
```

## test-conf/tests/drivers/uart/uart_elementary/testcase.yaml
```yaml
tests:
  drivers.uart.uart_elementary.uart_tt_virt:
    tags: tt_sim
    filter: CONFIG_SERIAL_SUPPORT_INTERRUPT
    platform_allow:
      - native_sim/native/64
    extra_args:
      - "DTC_OVERLAY_FILE=\
        ../../../../../tt-zephyr-platforms/test-conf/tests/drivers/uart/uart_elementary/\
        uart_tt_virt.overlay"
      - "CONF_FILE=\
        ../../../../../tt-zephyr-platforms/test-conf/tests/drivers/uart/uart_elementary/\
        uart_tt_virt.conf"
  drivers.uart.uart_elementary.grendel_uart:
    tags: smoke
    platform_allow:
      - tt_grendel_smc
    extra_args:
      - "DTC_OVERLAY_FILE=\
        ../../../../../tt-zephyr-platforms/test-conf/tests/drivers/uart/uart_elementary/\
        tt_grendel_smc.overlay"
      - "CONF_FILE=\
        ../../../../../tt-zephyr-platforms/test-conf/tests/drivers/uart/uart_elementary/\
        tt_grendel_smc.conf"
```

## tests/boards/tenstorrent/tt_blackhole/dmc/gpiox/testcase.yaml
```yaml
tests:
  boards.tenstorrent.tt_blackhole.bmc.gpiox:
    tags:
      - i2c
      - gpio
      - smoke
    filter: dt_compat_enabled("nxp,pca9554") or dt_compat_enabled("nxp,pca9555")
```

## tests/boards/tenstorrent/tt_blackhole/ina228/Kconfig
```kconfig
# Copyright (c) 2025 Tenstorrent AI ULC
# SPDX-License-Identifier: Apache-2.0

source "Kconfig.zephyr"

config TDP_LIMIT
	int "Tenstorrent Blackhole TDP Limit"
```

## tests/boards/tenstorrent/tt_blackhole/ina228/testcase.yaml
```yaml
tests:
  drivers.sensor.ina228.basic:
    tags:
      - drivers
      - sensor
      - ina228
    platform_allow:
      - tt_blackhole@p100a/tt_blackhole/dmc
      - tt_blackhole@p150a/tt_blackhole/dmc
      - tt_blackhole@p300a/tt_blackhole/dmc
    extra_args:
      - "platform:tt_blackhole@p100a/tt_blackhole/dmc:CONFIG_TDP_LIMIT=100"
      - "platform:tt_blackhole@p150a/tt_blackhole/dmc:CONFIG_TDP_LIMIT=150"
      - "platform:tt_blackhole@p300a/tt_blackhole/dmc:CONFIG_TDP_LIMIT=86"
```

## tests/boards/tenstorrent/tt_blackhole/max6639/testcase.yaml
```yaml
tests:
  boards.tenstorrent.tt_blackhole.max6639:
    tags:
      - i2c
      - mfd
      - pwm
      - sensor
      - smoke
    filter: dt_compat_enabled("maxim,max6639")
```

## tests/boards/tenstorrent/tt_grendel_smc/clock_control/testcase.yaml
```yaml
common:
  tags:
    - smoke
    - drivers
    - clock_control
tests:
  drivers.clock_control.grendel_smc.basic:
    platform_allow:
      - tt_mimir/tt_mimir/smc
    extra_args:
      - "platform:tt_mimir/tt_mimir/smc:DTC_OVERLAY_FILE=app.overlay"
```

## tests/drivers/firmware/rpmi/common/testcase.yaml
```yaml
tests:
  drivers.drivers.firmware.rpmi.common:
    platform_allow:
      - native_sim
    tags:
      - drivers
      - rpmi
```

## tests/drivers/flash/performance/testcase.yaml
```yaml
common:
  tags:
    - drivers
    - flash
tests:
  drivers.flash.performance.rtt.mx35:
    tags: smoke
    platform_allow:
      - tt_blackhole@p100/tt_blackhole/smc
    extra_configs:
      - CONFIG_SEGGER_RTT_BUFFER_SIZE_UP=4096
      # The below values are set experimentally. A test failure may
      # indicate a performance regression in the flash driver.
      - CONFIG_EXPECTED_READ_TIME=5
      - CONFIG_EXPECTED_PROGRAM_TIME=400
    required_snippets:
      - rtt-console
  drivers.flash.performance.rtt.mt25:
    tags: smoke
    platform_allow:
      - tt_blackhole@p100a/tt_blackhole/smc
      - tt_blackhole@p150a/tt_blackhole/smc
      - tt_blackhole@p300a/tt_blackhole/smc
    extra_configs:
      - CONFIG_SEGGER_RTT_BUFFER_SIZE_UP=4096
      # The below values are set experimentally. A test failure may
      # indicate a performance regression in the flash driver.
      - CONFIG_EXPECTED_READ_TIME=8
      - CONFIG_EXPECTED_PROGRAM_TIME=400
    required_snippets:
      - rtt-console
```

## tests/drivers/misc/bh_fwtable/testcase.yaml
```yaml
tests:
  drivers.misc.bh_fwtable.external_conf_test:
    tags:
      - drivers
      - misc
      - bh_fwtable
    platform_allow:
      - tt_blackhole@p100/tt_blackhole/smc
      - tt_blackhole@p100a/tt_blackhole/smc
      - tt_blackhole@p150a/tt_blackhole/smc
      - tt_blackhole@p150b/tt_blackhole/smc
      - tt_blackhole@p300a/tt_blackhole/smc
    extra_args:
      - CONF_FILE=../../../test-conf/tt_blackhole_tt_blackhole_smc.conf
      - DTC_OVERLAY_FILE=../../../test-conf//tt_blackhole_tt_blackhole_smc.overlay
```

## tests/drivers/tt_smc_remoteproc/Kconfig
```kconfig
# Copyright (c) 2025 Tenstorrent AI ULC
# SPDX-License-Identifier: Apache-2.0

# These Kconfigs are set by sysbuild when building for Grendel platforms,
# indicating that we have a secondary binary for the SMC to load

config BOOT_REMOTE_SMC
	bool "Boot remote SMC chiplet"
	help
	  Enable support for booting a remote SMC chiplet using the
	  remoteproc API over OCCP.

if BOOT_REMOTE_SMC

config REMOTE_SMC_BINARY_HEADER
	string "Path to header file for remote SMC binary"
	help
	  Path to the header file for the remote SMC binary to be loaded.

endif

source "Kconfig.zephyr"
```

## tests/drivers/tt_smc_remoteproc/testcase.yaml
```yaml
common:
  tags:
    - drivers
tests:
  drivers.tt_smc_remoteproc.bl1_primary:
    tags: smoke
    platform_allow:
      - tt_mimir/tt_mimir/smc
    sysbuild: true
```

## tests/drivers/watchdog/testcase.yaml
```yaml
tests:
  drivers.watchdog.basic:
    tags: smoke
    platform_allow:
      - tt_mimir/tt_mimir/smc
```

## tests/lib/tenstorrent/bh_arc/testcase.yaml
```yaml
tests:
  lib.tenstorrent.bh_arc:
    platform_allow: native_sim
    extra_args: DTC_OVERLAY_FILE=app.overlay
    tags: bh_arc
```

## tests/lib/tenstorrent/jtag_bootrom/testcase.yaml
```yaml
tests:
  lib.tenstorrent.jtag_bootrom.qemu:
    filter: dt_compat_enabled("zephyr,gpio-emul")
```

## tests/lib/tenstorrent/msgqueue/testcase.yaml
```yaml
tests:
  libraries.tenstorrent.msgqueue:
    tags:
      - msgqueue
      - tenstorrent
    platform_allow:
      - qemu_arc/qemu_arc_hs
```

## tests/lib/tenstorrent/occp/testcase.yaml
```yaml
common:
  tags:
    - drivers
tests:
  lib.tenstorrent.occp:
    tags: smoke
    platform_allow:
      - tt_mimir/tt_mimir/smc
```

## tests/lib/tenstorrent/pgood/testcase.yaml
```yaml
tests:
  lib.tenstorrent.pgood:
    filter: dt_compat_enabled("zephyr,gpio-emul")
```

## tests/lib/tenstorrent/spi_flash_buf/testcase.yaml
```yaml
tests:
  lib.tenstorrent.spi_flash_buf:
    platform_allow:
      - tt_blackhole@p100/tt_blackhole/smc
      - tt_blackhole@p100a/tt_blackhole/smc
      - tt_blackhole@p150a/tt_blackhole/smc
      - tt_blackhole@p300a/tt_blackhole/smc
    extra_args: DTC_OVERLAY_FILE=app.overlay
    tags: smoke
```

## tests/lib/tenstorrent/tt_boot_fs/testcase.yaml
```yaml
tests:
  lib.tenstorrent.boot_fs:
    platform_allow:
      - tt_blackhole@p150a/tt_blackhole/smc
    extra_args: DTC_OVERLAY_FILE=boards/tt_blackhole.overlay
  lib.tenstorrent.boot_fs.python:
    platform_allow:
      - native_sim
    # Although the zephyr pytest harness is usually used for testing host + device interaction,
    # here, we use it only to test the scripts/tt_boot_fs.py script.
    harness: pytest
    harness_config:
      pytest_root:
        - pytest/test-tt-boot-fs.py
```
