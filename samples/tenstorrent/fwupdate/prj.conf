## CMakeLists.txt
```
# SPDX-License-Identifier: Apache-2.0

cmake_minimum_required(VERSION 3.20.0)
find_package(Zephyr REQUIRED HINTS $ENV{ZEPHYR_BASE})
project(tt_fwupdate)

FILE(GLOB app_sources src/*.c)
target_sources(app PRIVATE ${app_sources})
```

## sample.yaml
```
sample:
  name: Tenstorrent Firmware Update
common:
  tags:
    - mcuboot
  harness: console
  harness_config:
    type: one_line
    regex:
      - ".*verified dmfw with checksum.*"
tests:
  sample.tenstorrent.fwupdate.qemu_x86:
    platform_allow:
      - qemu_x86
```

## prj.conf
```kconfig
CONFIG_FLASH=y
CONFIG_FLASH_MAP=y
CONFIG_FLASH_MAP_LABELS=y
CONFIG_LOG=y
# Uncomment the line below to increase log verbosity
CONFIG_TT_FWUPDATE_LOG_LEVEL_DBG=y
CONFIG_LOG_MODE_IMMEDIATE=y
CONFIG_LOG_PRINTK=y
CONFIG_MAIN_STACK_SIZE=2048
CONFIG_IMG_MANAGER=y
CONFIG_STREAM_FLASH=y
CONFIG_TT_BOOT_FS=y
CONFIG_TT_FWUPDATE=y
```

## boards/qemu_x86.conf
```kconfig
CONFIG_GPIO=n
CONFIG_FLASH_SIMULATOR=y
CONFIG_TT_FWUPDATE_TEST=y
CONFIG_FLASH_SIMULATOR_DOUBLE_WRITES=y
CONFIG_CRC=y

CONFIG_ASSERT=y
```

## boards/qemu_x86.overlay
```dts
#include <mem.h>

/ {
	chosen {
		zephyr,code-partition = &slot0_partition;
	};

	aliases {
	};
};

&sim_flash {
	erase-value = < 0xff >;
};
```

## src/main.c
```c
/*
 * Copyright (c) 2024 Tenstorrent AI ULC
 *
 * SPDX-License-Identifier: Apache-2.0
 */

#include <stdint.h>
#include <stdlib.h>
#include <string.h>

#include <tenstorrent/fwupdate.h>
#include <tenstorrent/tt_boot_fs.h>
#include <zephyr/devicetree.h>
#include <zephyr/drivers/gpio.h>
#include <zephyr/kernel.h>

static void on_button_press(const struct device *port, struct gpio_callback *cb,
			    gpio_port_pins_t pins)
{
	ARG_UNUSED(port);
	ARG_UNUSED(cb);
	ARG_UNUSED(pins);

	/* Device Mgmt FW (called bmfw here and elsewhere in this file for historical reasons) */
	tt_fwupdate("bmfw", false, true);
}

int main(void)
{
	int rc;
	static struct gpio_callback cb;
	static const struct gpio_dt_spec button = GPIO_DT_SPEC_GET_OR(DT_ALIAS(sw0), gpios, {0});

	/* without this, the bootloader assumes that the firmware upgrade did not work */
	tt_fwupdate_confirm();

#ifdef CONFIG_TT_FWUPDATE_TEST
	rc = tt_fwupdate_create_test_fs("bmfw");
	if (rc < 0) {
		printk("tt_fwupdate_create_test_fs() failed: %d\n", rc);
		return EXIT_FAILURE;
	}
#endif

	if (!IS_ENABLED(CONFIG_GPIO)) {
		on_button_press(NULL, NULL, 0);
		return EXIT_SUCCESS;
	}

	if (!gpio_is_ready_dt(&button)) {
		printk("Button device %s not ready\n", button.port->name);
		return EXIT_FAILURE;
	}

	rc = gpio_pin_configure_dt(&button, GPIO_INPUT);
	if (rc < 0) {
		printk("gpio_pin_configure_dt() failed: %d\n", rc);
		return EXIT_FAILURE;
	}

	rc = gpio_pin_interrupt_configure_dt(&button, GPIO_INT_EDGE_TO_ACTIVE);
	if (rc < 0) {
		printk("gpio_pin_interrupt_configure_dt() failed: %d\n", rc);
		return EXIT_FAILURE;
	}

	gpio_init_callback(&cb, on_button_press, BIT(button.pin));
	rc = gpio_add_callback(button.port, &cb);
	if (rc < 0) {
		printk("gpio_add_callback() failed: %d\n", rc);
		return EXIT_FAILURE;
	}

	printk("waiting for button press...\n");
	while (true) {
		k_msleep(1000);
	}

	return EXIT_SUCCESS;
}
```
