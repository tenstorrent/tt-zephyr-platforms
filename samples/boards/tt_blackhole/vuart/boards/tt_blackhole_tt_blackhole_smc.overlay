/*
 * Copyright (c) 2024 Tenstorrent AI ULC
 *
 * SPDX-License-Identifier: Apache-2.0
 */

/ {
	chosen {
		zephyr,console = &vuart0;
		zephyr,shell-uart = &vuart0;
	};
};

&vuart0 {
	status = "okay";
	current-speed = <0>;
};
